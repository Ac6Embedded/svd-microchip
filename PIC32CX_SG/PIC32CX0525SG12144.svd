# PIC32CX0525SG12144 register map
Vendor: Microchip Technology; Series: 0525SG12; File version: 0
Microchip PIC32CX0525SG12144 Microcontroller
CPU: CM4 r1p0, little endian, no MPU, no FPU, 3 interrupt priority bits, 172 interrupts
Registers are 32-bit, read-write, reset 0x0 unless marked. A register's access mark holds for its fields unless they carry their own. Offsets are from the block's base; lines under a group give offsets from that group; [hi:lo] are bit positions; {n}, {i} and the like mark numbered series; 'fields as' and 'values as' point back to an identical list; <NAME> marks a mode.

## Memory map
0x40000400 WDT size 0x15 — The function of the Watchdog Timer is to provide a mechanism to detect if the internal embedded controller has failed.
0x40000C00 TIMER16_0 size 0x14 — This 16-bit timer block offers a simple mechanism for firmware to maintain a time base
0x40000C20 TIMER16_1 size 0x14
0x40000C80 TIMER32_0 size 0x14 — This 32-bit timer block offers a simple mechanism for firmware to maintain a time base
0x40000CA0 TIMER32_1 size 0x14
0x40001000 CCT size 0x34 — This is a 16-bit auto-reloading timer/counter.
0x40002400 DMA_MAIN size 0x8 — DMA Main Registers
0x40002440 DMA_CHAN00 size 0x2C — DMA Channel 00 Registers
0x40002480 DMA_CHAN01 size 0x2C — DMA Channel 01 Registers
0x400024C0 DMA_CHAN02 size 0x19 — DMA Channel 02 Registers
{0x40002440+0x40*n} DMA_CHAN{n:02} size 0x19 (n=3..11)
0x40003400 PHOT size 0x18 — This block monitors the PROCHOT# signal generated by the host processor. It is designed to detect single assertions and monitor cumulative PROCHOT active time.
0x40004000 SMB0 size 0x79 — The SMBus interface can handle standard SMBus 2.0 protocols as well as I2C interface.
0x40004400 SMB1 size 0x79
0x40004800 SMB2 size 0x79
0x40004C00 SMB3 size 0x79
0x40005000 SMB4 size 0x79
0x40005100 I2C0 size 0x79 — The I2C interface can handle standard I2C interface.
0x40005200 I2C1 size 0x79
0x40005300 I2C2 size 0x79
0x40005800 PWM0 size 0xC — The PWM block generates an arbitrary duty cycle output at frequencies from less than 0.1 Hz to 24 MHz
{0x40005800+0x10*n} PWM{n} size 0xC (n=1..8)
0x40006000 TACH0 size 0x10 — This block monitors TACH output signals from various types of fans, and determines their speed.
0x40006010 TACH1 size 0x10
0x40006020 TACH2 size 0x10
0x40006030 TACH3 size 0x10
0x40006400 PECI size 0x48 — The PECI Interface allows the EC to retrieve temperature readings from PECI-compliant devices.
0x40006800 HDMI_CEC size 0x24 — The HDMI-CEC provides high-level control functions between all the various audiovisual products in a users environment.
0x40007000 SPI_SLAVE size 0x4C
0x40007400 RTOS size 0x10 — RTOS is a 32-bit timer designed to operate on the 32kHz oscillator which is available during all chip sleep states.
0x40007C00 ADC size 0x90 — This block is designed to convert external analog voltage readings into digital values.
0x40008000 SAFBC size 0x1B4 — SAF BRIDGE COMPONENT
0x40008C00 TFDP size 0x5 — The TFDP serially transmits EC-originated diagnostic vectors to an external debug trace system.
0x40009000 PS2_0 size 0xC — The four PS/2 Ports implementation eliminates the need to bit bang I/O ports to generate PS/2 traffic
0x40009040 PS2_1 size 0xC
0x40009800 HTM0 size 0xA — The Hibernation Timer can generate a wake event to the Embedded Controller (EC) when it is in a hibernation mode
0x40009820 HTM1 size 0xA
0x40009C00 KMS size 0x18 — The Keyboard Scan Interface block provides a register interface to directly scan an external keyboard matrix of size up to 18x8.
0x4000A000 SGPIO0 size 0x15 — This is Serial General Purpous Input Output block
0x4000A100 SGPIO1 size 0x15
0x4000A200 SGPIO2 size 0x15
0x4000A300 SGPIO3 size 0x15
0x4000A400 VBAT size 0x2C — The VBAT Register Bank block is a block implemented for miscellaneous battery-backed registers
0x4000A800 VBAT_RAM size 0x40 — The VBAT RAM is operational while the main power rail is operational, and will retain its values powered by battery power while the main rail is unpowered.
0x4000AC80 WEEK size 0x28 — The Week Timer and the Sub-Week Timer assert the Power-Up Event Output which automatically powers-up the system from the G3 state
0x4000AE00 VCI size 0x24 — The VBAT-Powered Control Interfaces with the RTC With Date and DST Adjustment as well as the Week Alarm.
0x4000B800 LED0 size 0x18 — The LED is implemented using a PWM that can be driven either by the 48 MHz clock or by a 32.768 KHz clock input.
0x4000B900 LED1 size 0x18
0x4000BA00 LED2 size 0x18
0x4000E000 ECIA size 0x20C — The ECIA works in conjunction with the processor interrupt interface to handle hardware interrupts andd exceptions.
0x4000FC00 EC_REG_BANK size 0x190 — This block is designed to be accessed internally by the EC via the register interface.
0x40070000 QMSPI size 0x70 — The QMSPI may be used to communicate with various peripheral devices that use a Serial Peripheral Interface
0x40071000 SAFCOMM size 0x2BC — This region contains one register “SAF Communication Mode” that may (and should) be set for optimal SAFS operation
0x40080100 PCR size 0x88 — The Power, Clocks, and Resets (PCR) Section identifies clock sources, and reset inputs to the chip
0x40081000 GPIO size 0x7C4 — GPIO Pin Control Registers
0x40082000 OTP size 0x4C — OTP Programming registers.
0x400F0000 MBX size 0x130 — The Mailbox provides a standard run-time mechanism for the host to communicate with the Embedded Controller (EC).
0x400F0400 KBC size 0x331 — The Keyboard Controller is a Host/EC Message Interface with hardware assists to emulate 8042 behavior
0x400F0800 ACPI_EC0 size 0x10C — The ACPI-ECI provides a four byte full duplex data interface.
0x400F0C00 ACPI_EC1 size 0x10C
0x400F1000 ACPI_EC2 size 0x10C
0x400F1400 ACPI_EC3 size 0x10C
0x400F1C00 PM1 size 0x111 — These features comply with the ACPI Specification through a combination of hardware and EC software
0x400F2000 PORT92 size 0x331 — The registers listed in the Configuration Register Summary table are for a single instance of the Legacy Port92/GATEA20 logic.
0x400F2400 UART0 size 0x3F1 — The 16550 UART is a full-function Two Pin Serial Port that supports the standard RS-232 Interface.
0x400F2800 UART1 size 0x3F1
0x400F2C00 UART2 size 0x3F1
0x400F3400 ESPI_IO size 0x3F1 — The ESPI is used by the system host to configure the chip and communicate with the logical devices implemented in the design
0x400F3800 ESPI_MEMORY size 0x3C0 — The eSPI Memory Component is one of two Logical Devices (along with the I/O Component) that provide access to all the registers in the device.
0x400F4000 EMI0 size 0x118 — The EMI provides a communication between system host and Embedded Controller
0x400F4400 EMI1 size 0x118
0x400F5000 RTC size 0x20 — This is the set of registers that are automatically counted by hardware every 1 second while the block is enabled
0x400F8000 PORT_80_DEBUG0 size 0x334 — Diagnostic data is written by the Host Interface to the Port 80 BIOS Debug Port
0x400F8400 PORT_80_DEBUG1 size 0x334
0x400F9C00 ESPI_MSVW00_06 size 0x54 — The ESPI VW Channel permits the System to emulate a set of wires that interconnect the system Core Logic with the EC
0x400F9C54 ESPI_MSVW07_10 size 0x30 — The ESPI VW Channel permits the System to emulate a set of wires that interconnect the system Core Logic with the EC
0x400F9E00 ESPI_SMVW00_10 size 0x58 — The ESPI VW Channel permits the System to emulate a set of wires that interconnect the system Core Logic with the EC
0x400FBC00 ESPI_SCRATCH size 0x20 — 32 Byte ESPI Test Register
0x400FFF00 GCR size 0x22 — The Logical Device Configuration registers support motherboard designs in which the resources required by their components are known and assigned by the BIOS at POST.
0xE000E000 SystemControl size 0xD8C — System Control Registers
0xE000E010 SysTick size 0x10 — System timer
0xE000E100 NVIC size 0xE04 — Nested Vectored Interrupt Controller

## Interrupts
0 GIRQ08 (GPIO)
1 GIRQ09 (GPIO)
2 GIRQ10 (GPIO)
3 GIRQ11 (GPIO)
4 GIRQ12 (GPIO)
5 GIRQ13 (SMB0)
6 GIRQ14 (DMA_CHAN00)
7 GIRQ15 (UART0)
9 GIRQ17 (PECI)
10 GIRQ18 (QMSPI)
11 GIRQ19 (ESPI_IO)
12 GIRQ20 (OTP)
13 GIRQ21 (WDT)
14 GIRQ23 (TIMER16_0)
15 GIRQ24 (ESPI_MSVW00_06)
16 GIRQ25 (ESPI_MSVW07_10)
17 GIRQ26 (GPIO)
20 I2CSMB0 (SMB0)
21 I2CSMB1 (SMB1)
22 I2CSMB2 (SMB2)
23 I2CSMB3 (SMB3)
{n+24} DMA_CH{n:02} (DMA_CHAN{n:02}) (n=0..11)
40 UART0
41 UART1
42 EMI0
43 EMI1
44 UART2
45 AEC0_IBF (ACPI_EC0)
46 AEC0_OBE (ACPI_EC0)
47 AEC1_IBF (ACPI_EC1)
48 AEC1_OBE (ACPI_EC1)
49 AEC2_IBF (ACPI_EC2)
50 AEC2_OBE (ACPI_EC2)
51 AEC3_IBF (ACPI_EC3)
52 AEC3_OBE (ACPI_EC3)
55 APM1_CTL (PM1)
56 APM1_EN (PM1)
57 APM1_STS (PM1)
58 KBC_OBE (KBC)
59 KBC_IBF (KBC)
60 MBOX (MBX)
62 P80CAP0 (PORT_80_DEBUG0)
63 P80CAP1 (PORT_80_DEBUG1)
70 PECI
71 TACH0
72 TACH1
73 TACH2
78 ADC_SNGL (ADC)
79 ADC_RPT (ADC)
83 LED0
84 LED1
85 LED2
87 PHOT
90 SPISLV (SPI_SLAVE)
91 QMSPI
100 PS2_0_ACT (PS2_0)
101 PS2_1_ACT (PS2_1)
103 INTR_PC (ESPI_IO)
104 INTR_BM1 (ESPI_IO)
105 INTR_BM2 (ESPI_IO)
106 INTR_LTR (ESPI_IO)
107 INTR_OOB_UP (ESPI_IO)
108 INTR_OOB_DOWN (ESPI_IO)
109 INTR_FLASH (ESPI_IO)
110 ESPI_RESET (ESPI_IO)
111 TMR (RTOS)
112 HTMR0 (HTM0)
113 HTMR1 (HTM1)
114 WK (WEEK)
115 WKSUB (WEEK)
116 WKSEC (WEEK)
117 WKSUBSEC (WEEK)
118 SYSPWR (WEEK)
119 RTC
120 RTC_ALARM (RTC)
121 VCI_OVRD_IN (VCI)
122 VCI_IN0 (VCI)
123 VCI_IN1 (VCI)
124 VCI_IN2 (VCI)
125 VCI_IN3 (VCI)
129 PS2_0A_WAKE (PS2_0)
130 PS2_0B_WAKE (PS2_0)
132 PS2_1B_WAKE (PS2_1)
135 KEYSCAN (KMS)
136 TIMER16_0
137 TIMER16_1
140 TIMER32_0
141 TIMER32_1
146 CCT
147 CCT_CAP0 (CCT)
148 CCT_CAP1 (CCT)
149 CCT_CAP2 (CCT)
150 CCT_CAP3 (CCT)
151 CCT_CAP4 (CCT)
152 CCT_CAP5 (CCT)
153 CCT_CMP0 (CCT)
154 CCT_CMP1 (CCT)
156 ESPI_VWIRE (ESPI_IO)
158 I2CSMB4 (SMB4)
159 TACH3
160 CEC (HDMI_CEC)
161 SGPIO0
162 SGPIO1
163 SGPIO2
164 SGPIO3
166 SAF_DONE (SAFBC)
167 SAF_ERR (SAFBC)
168 I2C0
169 I2C1
170 I2C2
171 WDT

## Notices in the file
Copyright (c) 2023 Microchip Technology Inc.
SPDX-License-Identifier: Apache-2.0
Licensed under the Apache License, Version 2.0 (the "License");
you may not use this file except in compliance with the License.
You may obtain a copy of the License at
http://www.apache.org/licenses/LICENSE-2.0
Unless required by applicable law or agreed to in writing, software
distributed under the License is distributed on an "AS IS" BASIS,
WITHOUT WARRANTIES OR CONDITIONS OF ANY KIND, either express or implied.
See the License for the specific language governing permissions and
limitations under the License.
