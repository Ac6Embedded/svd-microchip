# SAM9X60D6K register map
Vendor: Microchip Technology; Series: SAM9X6; File version: 0
Microchip SAM9X60D6K Microcontroller
Registers are 32-bit, read-write, reset 0x0 unless marked. A register's access mark holds for its fields unless they carry their own. Offsets are from the block's base; lines under a group give offsets from that group; [hi:lo] are bit positions; {n}, {i} and the like mark numbered series; 'fields as' and 'values as' point back to an identical list; <NAME> marks a mode.

## Memory map
0x00600000 UHPHS_OHCI size 0x60 — USB Host Full-Speed Port
0x00700000 UHPHS_EHCI size 0xB0 — USB Host High Speed Port
0x80000000 SDMMC0 size 0x238 — Secure Digital MultiMedia Card Controller
0x90000000 SDMMC1 size 0x238
0xEFF00000 OTPC size 0xEC — OTP Memory Controller
0xF0000000 FLEXCOM4 size 0x6EC
0xF0004000 FLEXCOM5 size 0x6EC
0xF0008000 XDMAC size 0x450 — Extensible DMA Controller
0xF0010000 SSC size 0xEC — Synchronous Serial Controller
0xF0014000 QSPI size 0xEC — Quad Serial Peripheral Interface
0xF0018000 GFX2D size 0x80 — 2D Graphics Engine
0xF001C000 I2SMCC size 0xEC — Inter-IC Sound Multi Channel Controller
0xF0020000 FLEXCOM11 size 0x6EC
0xF0024000 FLEXCOM12 size 0x6EC
0xF0028000 PIT64B size 0xEC — Periodic Interval Timer 64-bit
0xF002C000 SHA size 0xEC — Secure Hash Algorithm
0xF0030000 TRNG size 0xEC — True Random Number Generator
0xF0034000 AES size 0xEC — Advanced Encryption Standard
0xF0038000 TDES size 0xEC — Triple Data Encryption Standard
0xF003C000 CLASSD size 0xE8 — Audio Class D Amplifier
0xF8000000 CAN0 size 0x300 — Controller Area Network
0xF8004000 CAN1 size 0x300
0xF8008000 TC0 size 0xE8 — Timer Counter
0xF800C000 TC1 size 0xE8
0xF8010000 FLEXCOM6 size 0x6EC
0xF8014000 FLEXCOM7 size 0x6EC
0xF8018000 FLEXCOM8 size 0x6EC
0xF801C000 FLEXCOM0 size 0x6EC — Flexible Serial Communication
0xF8020000 FLEXCOM1 size 0x6EC
0xF8024000 FLEXCOM2 size 0x6EC
0xF8028000 FLEXCOM3 size 0x6EC
0xF802C000 EMAC0 size 0xC8 — Ethernet MAC 10/100
0xF8030000 EMAC1 size 0xC8
0xF8034000 PWM size 0x280 — Pulse Width Modulation Controller
0xF8038000 LCDC size 0x1600 — LCD Controller
0xF803C000 UDPHS size 0x370 — USB High Speed Device Port
0xF8040000 FLEXCOM9 size 0x6EC
0xF8044000 FLEXCOM10 size 0x6EC
0xF8048000 ISI size 0xEC — Image Sensor Interface
0xF804C000 ADC size 0xEC — Analog-to-Digital Converter
0xF8050000 SFR size 0xE8 — Special Function Registers
0xFFFFDE00 MATRIX size 0x1EC — AHB Bus Matrix
0xFFFFE000 PMECC size 0x440 — Programmable Multibit Error Correction Code Controller
0xFFFFE600 PMERRLOC size 0xEC — Programmable Multibit ECC Error Location
0xFFFFE800 MPDDRC size 0xEC — AHB Multiport DDR-SDRAM Controller
0xFFFFEA00 SMC size 0xEC — Static Memory Controller
0xFFFFEC00 SDRAMC size 0x44 — SDRAM Controller
0xFFFFF100 AIC size 0xEC — Advanced Interrupt Controller
0xFFFFF200 DBGU size 0xE8 — Debug Unit
0xFFFFF400 PIOA size 0x11C — Parallel Input/Output Controller
0xFFFFF600 PIOB size 0x11C
0xFFFFF800 PIOC size 0x11C
0xFFFFFA00 PIOD size 0x11C
0xFFFFFC00 PMC size 0xF4 — Power Management Controller
0xFFFFFE00 RSTC size 0xC — Reset Controller
0xFFFFFE10 SHDWC size 0x10 — Shutdown Controller
0xFFFFFE20 RTT size 0x18 — Real-time Timer
0xFFFFFE40 PIT size 0x10 — Periodic Interval Timer
0xFFFFFE50 SCKC size 0x4 — Slow Clock Controller
0xFFFFFE54 BSC size 0x4 — Boot Sequence Controller
0xFFFFFE60 GPBR size 0x28 — General Purpose Backup Registers
0xFFFFFEA8 RTC size 0xC8 — Real-time Clock
0xFFFFFEDC SYSCWP size 0x8 — External Interrupt Controller
0xFFFFFF80 WDT size 0x24 — Watchdog Timer

## Interrupts
0 EXT_FIQ (AIC) — External FIQ
1 SYSC (PIT, PMC, RSTC, RTC, RTT, WDT) — System Controller Interrupt
2 PIOA — Parallel I/O Controller A
3 PIOB — Parallel I/O Controller B
4 PIOC — Parallel I/O Controller C
5 FLEXCOM0
6 FLEXCOM1
7 FLEXCOM2
8 FLEXCOM3
9 FLEXCOM6
10 FLEXCOM7
11 FLEXCOM8
12 SDMMC0 — Secure Digital Multi Media Card 0
13 FLEXCOM4
14 FLEXCOM5
15 FLEXCOM9
16 FLEXCOM10
17 TC0 — Timer Counter 0
18 PWM — Pulse Width Modulation
19 ADC — Analog to Digital Converter
20 XDMAC — Extended DMA Controller
21 MATRIX
23 UDPHS — USB Device High Speed
24 EMAC0 — Ethernet MAC 0
25 LCDC — LCD Controller
26 SDMMC1 — Secure Digital Multi Media Card 1
27 EMAC1 — Ethernet MAC 1
28 SSC — Synchronous Serial Controller
29 CAN0 — Controller Area Network 0
30 CAN1 — Controller Area Network 1
31 EXT_IRQ (AIC) — External IRQ
32 FLEXCOM11
33 FLEXCOM12
34 I2SMCC — I2S Multi Channel Controller
35 QSPI — Quad I/O SPI Controller
36 GFX2D — Graphics 2D Controller
37 PIT64B — Periodic Interval Timer 64-bit
38 TRNG — True Random Number Generator
39 AES — Advanced Encryption Standard
40 TDES — Triple Data Encryption Standard
41 SHA — Secure Hash Algorithm
42 CLASSD — Class D Controller
43 ISI — Image Sensor Interface
44 PIOD — Parallel I/O D
45 TC1 — Timer Counter 1
46 OTPC — One Time Programmable Controller
47 DBGU — Debug Unit
48 ECC (PMECC, PMERRLOC) — ECC Controller
49 MC (MPDDRC, SDRAMC, SMC) — Memory Controller

## Licence text in the file
Copyright (c) 2026 Microchip Technology Inc. SPDX-License-Identifier: Apache-2.0 Licensed under the Apache License, Version 2.0 (the "License"); you may not use this file except in compliance with the License. You may obtain a copy of the License at http://www.apache.org/licenses/LICENSE-2.0 Unless required by applicable law or agreed to in writing, software distributed under the License is distributed on an "AS IS" BASIS, WITHOUT WARRANTIES OR CONDITIONS OF ANY KIND, either express or implied. See the License for the specific language governing permissions and limitations under the License.
