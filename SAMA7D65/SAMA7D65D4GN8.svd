# SAMA7D65D4GN8 register map
Vendor: Microchip Technology; Series: SAMA7D6; File version: 0
Microchip SAMA7D65D4GN8 Microcontroller
Registers are 32-bit, read-write, reset 0x0 unless marked. A register's access mark holds for its fields unless they carry their own. Offsets are from the block's base; lines under a group give offsets from that group; [hi:lo] are bit positions; {n}, {i} and the like mark numbered series; 'fields as' and 'values as' point back to an identical list; <NAME> marks a mode.

## Memory map
0x00400000 UHPFS size 0x60 — USB Host Full-Speed Port
0x00500000 UHPHS size 0xB0 — USB Host High Speed Port
0xE0004000 SECUMOD size 0xA0 — Security Module
0xE0008000 SFRBU size 0x14 — Special Function Register Backup
0xE0010000 TZPM size 0x18 — TrustZone Peripheral Manager
0xE0014000 PIO size 0x15E8 — Parallel Input/Output Controller
0xE0018000 PMC size 0xF4 — Power Management Controller
0xE001C000 DWDT size 0x1030 — Dual Watchdog Timer
0xE001D100 RSTC size 0xE8 — Reset Controller
0xE001D200 SHDWC size 0x20 — Shutdown Controller
0xE001D300 RTT size 0x18 — Real-time Timer
0xE001D500 SCKC size 0x4 — Slow Clock Controller
0xE001D600 BSC size 0x8 — Boot Sequence Controller
0xE001D700 GPBR size 0x10 — General Purpose Backup Registers
0xE001D800 RTC size 0xC8 — Real-time Clock
0xE001D900 SYSCWP size 0x8 — System Controller Write Protection
0xE0020000 CHIPID size 0x8 — Chip Identifier
0xE0024000 PUF size 0x1EC — Physical Unclonable Functions
0xE0800000 TC1 size 0xE8
0xE0804000 MATRIX size 0x2A8 — AHB Bus Matrix (MATRIX2)
0xE0808000 HSMC size 0x7EC — Static Memory Controller
0xE080C000 QSPI0 size 0xEC — Quad Serial Peripheral Interface
0xE0810000 QSPI1 size 0xEC
0xE0814000 UDPHSA size 0x380 — IP_Name
0xE0818000 UDPHSB size 0x380
0xE081C000 ICM size 0xEC — Integrity Check Monitor
0xE0820000 TZAESB size 0xEC — TrustZone Advanced Encryption Standard Bridge
0xE0824000 TZAESBS size 0xEC
0xE0828000 MCAN0 size 0x1B4 — Controller Area Network
0xE082C000 MCAN1 size 0x1B4
0xE0830000 MCAN2 size 0x1B4
0xE0834000 MCAN3 size 0x1B4
0xE0838000 MCAN4 size 0x1B4
0xE083C000 TCPCA size 0xB8 — Battery Charging and Type-C Port Controller
0xE0840000 TCPCB size 0xB8
0xE1000000 ADC size 0x120 — Analog-to-Digital Converter
0xE1200000 XDMAC2 size 0x860
0xE1204000 SDMMC0 size 0x246 — Secure Digital MultiMedia Card Controller
0xE1208000 SDMMC1 size 0x246
0xE120C000 SDMMC2 size 0x246
0xE1400000 LCDC size 0x1700 — LCD Controller
0xE1404000 DSI size 0x194 — Display Serial Interface
0xE1408000 LVDSC size 0xEC — LVDS Controller
0xE1480000 GPU2DC size 0x668 — GPU 2D Controller
0xE1500000 NICGPV1 size 0xC4008
0xE1600000 AES size 0xEC — Advanced Encryption Standard
0xE1604000 SHA size 0xEC — Secure Hash Algorithm
0xE1608000 TDES size 0xEC — Triple Data Encryption Standard
0xE160C000 TRNG size 0xEC — True Random Number Generator
0xE1610000 XDMAC0 size 0x860 — Extensible DMA Controller
0xE1614000 XDMAC1 size 0x860
0xE1618000 GMAC0 size 0x1B84 — Gigabit Ethernet MAC
0xE161C000 GMAC1 size 0x1B84
0xE1800000 PIT64B0 size 0xEC — Periodic Interval Timer 64-bit
0xE1804000 PIT64B1 size 0xEC
0xE1808000 PIT64B2 size 0xEC
0xE180C000 SSC0 size 0xEC — Synchronous Serial Controller
0xE1810000 EIC size 0xEC — External Interrupt Controller
0xE1814000 ACC size 0xEC — Analog Comparator Controller
0xE1818000 PWM size 0x464 — Pulse Width Modulation Controller
0xE181C000 SFR size 0x2254 — Special Function Register
0xE1820000 FLEXCOM0 size 0x6EC — Flexible Serial Communication
0xE1824000 FLEXCOM1 size 0x6EC
0xE1828000 FLEXCOM2 size 0x6EC
0xE182C000 FLEXCOM3 size 0x6EC
0xE2000000 TZAESBASC size 0xEC — AES Bridge Address Space Controller
0xE2004000 PIT64B3 size 0xEC
0xE2008000 PIT64B4 size 0xEC
0xE200C000 PIT64B5 size 0xEC
0xE2010000 SSC1 size 0xEC
0xE2014000 TC0 size 0xE8 — Timer Counter
0xE2018000 FLEXCOM4 size 0x6EC
0xE201C000 FLEXCOM5 size 0x6EC
0xE2020000 FLEXCOM6 size 0x6EC
0xE2024000 FLEXCOM7 size 0x6EC
0xE2800000 PDMC0 size 0x48 — Pulse Density Microphone Controller
0xE2804000 PDMC1 size 0x48
0xE2808000 ASRC size 0xEC — Asynchronous Sample Rate Converter
0xE280C000 SPDIFRX size 0xEC — Sony/Philips Digital Interface Receiver
0xE2810000 SPDIFTX size 0xE8 — Sony/Philips Digital Interface
0xE2814000 I2SMCC0 size 0xEC — Inter-IC Sound Multi Channel Controller
0xE2818000 I2SMCC1 size 0xEC
0xE281C000 FLEXCOM8 size 0x6EC
0xE2820000 FLEXCOM9 size 0x6EC
0xE2824000 FLEXCOM10 size 0x6EC
0xE3000000 TZC size 0x1FC4 — TrustZone Address Space Controller (TZC)
0xE3800000 DDRUMCTL size 0x2244 — Enhanced Universal DDR-SDRAM Memory Controller
0xE3804000 DDRPUBL size 0x218 — DDR SDRAM PHY Utility Block Lite
0xE8B00000 NICGPV0 size 0xC4008 — NIC-400 Global Programmers View
0xE8C00000 OTPC size 0xEC — OTP Memory Controller
0xE9000000 I3CC size 0x25C — I3C Host Controller

## Interrupts
32 DWDT_SW (DWDT) — Dual Watchdog Timer, Secure World
33 DWDT_NSW (DWDT) — Dual Watchdog Timer, Non-secure World
34 DWDT_NSW_ALARM (DWDT) — Dual Watchdog Timer, Non-secure World Alarm
36 SHDWC — Shutdown Controller
37 RSTC — Reset Controller
38 RTC — Real-Time Clock
39 RTT — Real-Time Timer
41 PMC — Power Management Controller
42 PIOA (PIO) — For PIO 0 to 31
43 PIOB (PIO) — For PIO 32 to 63
44 PIOC (PIO) — For PIO 64 to 95
45 PIOD (PIO) — For PIO 96 to 127
46 PIOE (PIO) — For PIO 128 to 141
47 PUF — QK QuiddiKey IP + PUFSRAM
48 SECUMOD — Security Module
52 HSMC — Static Memory Controller - NAND Flash Controller
53 XDMAC0 — DMA 0, mem to periph, 32 channels
54 XDMAC1 — DMA 1, mem to periph, 32 channels
55 XDMAC2 — DMA 2, mem to mem, 8 channels
56 ACC — Analog Comparator Controller
57 ADC — Analog-to-Digital Converter
58 AES — Advanced Encryption Standard
61 ASRC — Asynchronous Sample Rate Converter
{n+66} FLEXCOM{n} (n=0..10) — FLEXCOM{n}. Max Generic Clock Frequency = FPCLOCK 3.
77 GPU2DC — Graphic Processor Unit 2D Composer
78 GMAC0 — Gigabit Ethernet MAC + TSN support
79 GMAC1 — Gigabit Ethernet MAC + TSN support
81 GMAC0_TSU (GMAC0) — Gigabit Ethernet MAC - Timestamp Unit Generic Clock - No Interrupt
82 GMAC1_TSU (GMAC1) — Gigabit Ethernet MAC - Timestamp Unit Generic Clock - No Interrupt
85 ICM — Integrity Check Monitor
86 I2SMCC0 — Inter-IC Sound Controller 0
87 I2SMCC1 — Inter-IC Sound Controller 1
88 LCDC — LCD controller
89 MATRIX — AHB Matrix
90 MCAN0_INT0 (MCAN0) — Host CAN 0
91 MCAN1_INT0 (MCAN1) — Host CAN 1
92 MCAN2_INT0 (MCAN2) — Host CAN 2
93 MCAN3_INT0 (MCAN3) — Host CAN 3
94 MCAN4_INT0 (MCAN4) — Host CAN 4
95 OTPC — One Time Programmable Memory Controller
96 PDMC0 — Pulse Density Modulation Interface Controller 0
97 PDMC1 — Pulse Density Modulation Interface Controller 1
98 PIT64B0 — 64-bit Periodic Interval Timer 0
99 PIT64B1 — 64-bit Periodic Interval Timer 1
100 PIT64B2 — 64-bit Periodic Interval Timer 2
101 PIT64B3 — 64-bit Periodic Interval Timer 3
102 PIT64B4 — 64-bit Periodic Interval Timer 4
103 PIT64B5 — 64-bit Periodic Interval Timer 5
104 PWM — Pulse Width Modulation
105 QSPI0 — Quad IO Serial Peripheral Interface 0
106 QSPI1 — Quad IO Serial Peripheral Interface 1
107 SDMMC0 — Ultra High Speed SD Host Controller 0 (e.MMC 5.1)
108 SDMMC1 — Ultra High Speed SD Host Controller 1 (e.MMC 4.51)
109 SDMMC2 — Ultra High Speed SD Host Controller 2 (e.MMC 4.51)
110 SHA — Secure Hash Algorithm
111 SPDIFRX — Sony Philips Digital Interface RX
112 SPDIFTX — Sony Philips Digital Interface TX
113 SSC0 — Synchronous Serial Interface 0
114 SSC1 — Synchronous Serial Interface 1
115 TC0_CH0 (TC0) — 32-bit Timer Counter 0 Channel 0 interrupt
116 TC0_CH1 (TC0) — 32-bit Timer Counter 0 Channel 1 interrupt
117 TC0_CH2 (TC0) — 32-bit Timer Counter 0 Channel 2 interrupt
118 TC1_CH0 (TC1) — 32-bit Timer Counter 1 Channel 0 interrupt
119 TC1_CH1 (TC1) — 32-bit Timer Counter 1 Channel 1 interrupt
120 TC1_CH2 (TC1) — 32-bit Timer Counter 1 Channel 2 interrupt
121 TCPCA — USB Type-C Port Controller A
122 TCPCB — USB Type-C Port Controller B
123 TDES — Triple Data Encryption Standard
124 TRNG — True Random Number Generator
125 TZAESB_NS (TZAESB) — TrustZone Advanced Encryption Standard Bridge Non-Secure (Clocks and Interrupt)
126 TZAESB_NS_SINT (TZAESB) — TrustZone Advanced Encryption Standard Bridge Non-Secure (Interrupt only)
127 TZAESB_S (TZAESB) — TrustZone Advanced Encryption Standard Bridge Secure (Interrupt only)
128 TZAESB_S_SINT (TZAESB) — TrustZone Advanced Encryption Standard Bridge Secure (Interrupt only)
129 TZC — TrustZone Address Space Controller (TZC400)
131 UDPHSA — USB Device High Speed A
132 UDPHSB — USB Device High Speed B
133 UHPHS — USB Host Controller High Speed
135 DSI — Display Serial Interface Host interrupt and MIPI DPHY clock
137 I3CC — I3C Controller
141 XDMAC0_SINT (XDMAC0) — DMA0, mem to periph, 32 channels, Secure Interrupt
142 XDMAC1_SINT (XDMAC1) — DMA1, mem to periph, 32 channels, Secure Interrupt
143 XDMAC2_SINT (XDMAC2) — DMA2, mem to mem, 8 channels, Secure Interrupt
144 AES_SINT (AES) — Advanced Encryption Standard, Secure Interrupt
145 ICM_SINT (ICM) — Integrity Check Monitor, Secure Interrupt
146 MCAN0_INT1 (MCAN0) — MCAN0 Interrupt1
147 MCAN1_INT1 (MCAN1) — MCAN1 Interrupt1
148 MCAN2_INT1 (MCAN2) — MCAN2 Interrupt1
149 MCAN3_INT1 (MCAN3) — MCAN3 Interrupt1
150 MCAN4_INT1 (MCAN4) — MCAN4 Interrupt1
151 PIOA_SINT (PIO) — For PIO 0 to 31, Secure Interrupt
152 PIOB_SINT (PIO) — For PIO 32 to 63, Secure Interrupt
153 PIOC_SINT (PIO) — For PIO 64 to 95, Secure Interrupt
154 PIOD_SINT (PIO) — For PIO 96 to 127, Secure Interrupt
155 PIOE_SINT (PIO) — For PIO 128 to 141, Secure Interrupt
162 SDMMC0_TIMER (SDMMC0) — Ultra High Speed SD Host Controller 0 (e.MMC 5.1) Timer interrupt
163 SDMMC1_TIMER (SDMMC1) — Ultra High Speed SD Host Controller 1 (e.MMC 4.51) Timer interrupt
164 SDMMC2_TIMER (SDMMC2) — Ultra High Speed SD Host controller 2 (eMMC 4.51) Timer interrupt
165 SHA_SINT (SHA) — Secure Hash Algorithm, Secure Interrupt
172 TDES_SINT (TDES) — Triple Data Encryption Standard, Secure Interrupt
173 TRNG_SINT (TRNG) — True Random Number Generator, Secure Interrupt
174 EIC_EXT_IRQ0 (EIC) — External Interrupt ID0
175 EIC_EXT_IRQ1 (EIC) — External Interrupt ID1
176 GMAC0_Q1 (GMAC0) — GMAC0 Queue 1 Interrupt signal toggled on a DMA write to the first word of each DMA data buffer associated with queue 1
177 GMAC0_Q2 (GMAC0) — GMAC0 Queue 2 Interrupt signal toggled on a DMA write to the first word of each DMA data buffer associated with queue 2
178 GMAC0_Q3 (GMAC0) — GMAC0 Queue 3 Interrupt signal toggled on a DMA write to the first word of each DMA data buffer associated with queue 3
179 GMAC0_Q4 (GMAC0) — GMAC0 Queue 4 Interrupt signal toggled on a DMA write to the first word of each DMA data buffer associated with queue 4
180 GMAC0_Q5 (GMAC0) — GMAC0 Queue 5 Interrupt signal toggled on a DMA write to the first word of each DMA data buffer associated with queue 5
181 GMAC0_EMAC (GMAC0) — GMAC0: Express MAC
182 GMAC0_MMSL (GMAC0) — GMAC0: MAC Merge Sublayer
183 GMAC1_Q1 (GMAC1) — GMAC1 Queue 1 Interrupt signal toggled on a DMA write to the first word of each DMA data buffer associated with queue 1
184 GMAC1_Q2 (GMAC1) — GMAC1 Queue 2 Interrupt signal toggled on a DMA write to the first word of each DMA data buffer associated with queue 2
185 GMAC1_Q3 (GMAC1) — GMAC1 Queue 3 Interrupt signal toggled on a DMA write to the first word of each DMA data buffer associated with queue 3
186 GMAC1_Q4 (GMAC1) — GMAC1 Queue 4 Interrupt signal toggled on a DMA write to the first word of each DMA data buffer associated with queue 4
187 GMAC1_Q5 (GMAC1) — GMAC1 Queue 5 Interrupt signal toggled on a DMA write to the first word of each DMA data buffer associated with queue 5
188 GMAC1_EMAC (GMAC1) — GMAC1: Express MAC
189 GMAC1_MMSL (GMAC1) — GMAC1: MAC Merge Sublayer

## Licence text in the file
Copyright (c) 2026 Microchip Technology Inc. SPDX-License-Identifier: Apache-2.0 Licensed under the Apache License, Version 2.0 (the "License"); you may not use this file except in compliance with the License. You may obtain a copy of the License at http://www.apache.org/licenses/LICENSE-2.0 Unless required by applicable law or agreed to in writing, software distributed under the License is distributed on an "AS IS" BASIS, WITHOUT WARRANTIES OR CONDITIONS OF ANY KIND, either express or implied. See the License for the specific language governing permissions and limitations under the License.
