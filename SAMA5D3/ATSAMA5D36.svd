# ATSAMA5D36 register map
Vendor: Microchip Technology; Series: SAMA5D3; File version: 0
Microchip ATSAMA5D36 Microcontroller
Registers are 32-bit, read-write, reset 0x0 unless marked. A register's access mark holds for its fields unless they carry their own. Offsets are from the block's base; lines under a group give offsets from that group; [hi:lo] are bit positions; {n}, {i} and the like mark numbered series; 'fields as' and 'values as' point back to an identical list; <NAME> marks a mode.

## Memory map
0x00400000 SMD size 0x10 — Software Modem Device
0x00800000 AXIMX size 0x4 — AXI Matrix
0xF0000000 HSMCI0 size 0x600 — High Speed MultiMedia Card Interface
0xF0004000 SPI0 size 0xEC — Serial Peripheral Interface
0xF0008000 SSC0 size 0xEC — Synchronous Serial Controller
0xF000C000 CAN0 size 0x300 — Controller Area Network
0xF0010000 TC0 size 0xE8 — Timer Counter
0xF0014000 TWI0 size 0xEC — Two-wire Interface
0xF0018000 TWI1 size 0xEC
0xF001C000 USART0 size 0xEC — Universal Synchronous Asynchronous Receiver Transmitter
0xF0020000 USART1 size 0xEC
0xF0024000 UART0 size 0x24 — Universal Asynchronous Receiver Transmitter
0xF0028000 GMAC size 0x200 — Gigabit Ethernet MAC
0xF002C000 PWM size 0x280 — Pulse Width Modulation Controller
0xF0030000 LCDC size 0x1A00 — LCD Controller
0xF0034000 ISI size 0xEC — Image Sensor Interface
0xF0038000 SFR size 0x44 — Special Function Registers
0xF8000000 HSMCI1 size 0x600
0xF8004000 HSMCI2 size 0x600
0xF8008000 SPI1 size 0xEC
0xF800C000 SSC1 size 0xEC
0xF8010000 CAN1 size 0x300
0xF8014000 TC1 size 0xE8
0xF8018000 ADC size 0xEC — Analog-to-Digital Converter
0xF801C000 TWI2 size 0xEC
0xF8020000 USART2 size 0xEC
0xF8024000 USART3 size 0xEC
0xF8028000 UART1 size 0x24
0xF802C000 EMAC size 0xC8 — Ethernet MAC 10/100
0xF8030000 UDPHS size 0x370 — USB High Speed Device Port
0xF8034000 SHA size 0xC0 — Secure Hash Algorithm
0xF8038000 AES size 0x70 — Advanced Encryption Standard
0xF803C000 TDES size 0x74 — Triple Data Encryption Standard
0xF8040000 TRNG size 0x54 — True Random Number Generator
0xFFFFC000 SMC size 0x6EC — Static Memory Controller
0xFFFFE400 FUSE size 0x30 — Fuse Controller
0xFFFFE600 DMAC0 size 0x1EC — DMA Controller
0xFFFFE800 DMAC1 size 0x1EC
0xFFFFEA00 MPDDRC size 0xEC — AHB Multi-port DDR-SDRAM Controller
0xFFFFEC00 MATRIX size 0x1EC — AHB Bus Matrix
0xFFFFEE00 DBGU size 0x4C — Debug Unit
0xFFFFF000 AIC size 0xEC — Advanced Interrupt Controller
0xFFFFF200 PIOA size 0x120 — Parallel Input/Output Controller
0xFFFFF400 PIOB size 0x120
0xFFFFF600 PIOC size 0x120
0xFFFFF800 PIOD size 0x120
0xFFFFFA00 PIOE size 0x120
0xFFFFFC00 PMC size 0x114 — Power Management Controller
0xFFFFFE00 RSTC size 0xC — Reset Controller
0xFFFFFE10 SHDWC size 0xC — Shutdown Controller
0xFFFFFE30 PIT size 0x10 — Periodic Interval Timer
0xFFFFFE40 WDT size 0xC — Watchdog Timer
0xFFFFFE50 SCKC size 0x4 — Slow Clock Controller
0xFFFFFE54 BSC size 0x4 — Boot Sequence Controller
0xFFFFFE60 GPBR size 0x10 — General Purpose Backup Registers
0xFFFFFEB0 RTC size 0x30 — Real-time Clock

## Interrupts
2 DBGU — Debug Unit Interrupt
6 PIOA — Parallel I/O Controller A
7 PIOB — Parallel I/O Controller B
8 PIOC — Parallel I/O Controller C
9 PIOD — Parallel I/O Controller D
10 PIOE — Parallel I/O Controller E
11 SMD — SMD Soft Modem
12 USART0
13 USART1
14 USART2
15 USART3
16 UART0
17 UART1
18 TWI0 — Two-Wire Interface 0
19 TWI1 — Two-Wire Interface 1
20 TWI2 — Two-Wire Interface 2
21 HSMCI0 — High Speed Multimedia Card Interface 0
22 HSMCI1 — High Speed Multimedia Card Interface 1
23 HSMCI2 — High Speed Multimedia Card Interface 2
24 SPI0 — Serial Peripheral Interface 0
25 SPI1 — Serial Peripheral Interface 1
26 TC0 — Timer Counter 0 (ch. 0, 1, 2)
27 TC1 (TC0) — Timer Counter 1 (ch. 3, 4, 5)
28 PWM — Pulse Width Modulation Controller
29 ADC — Touch Screen ADC Controller
30 DMAC0 — DMA Controller 0
31 DMAC1 — DMA Controller 1
33 UDPHS — USB Device High Speed
34 GMAC — Gigabit Ethernet MAC
35 EMAC — Ethernet MAC
36 LCDC — LCD Controller
37 ISI — Image Sensor Interface
38 SSC0 — Synchronous Serial Controller 0
39 SSC1 — Synchronous Serial Controller 1
40 CAN0 — CAN controller 0
41 CAN1 — CAN controller 1
42 SHA — Secure Hash Algorithm
43 AES — Advanced Encryption Standard
44 TDES — Triple Data EncryptionStandard
45 TRNG — True Random Number Generator
48 FUSE — Fuse Controller

## Licence text in the file
Copyright (c) 2026 Microchip Technology Inc. SPDX-License-Identifier: Apache-2.0 Licensed under the Apache License, Version 2.0 (the "License"); you may not use this file except in compliance with the License. You may obtain a copy of the License at http://www.apache.org/licenses/LICENSE-2.0 Unless required by applicable law or agreed to in writing, software distributed under the License is distributed on an "AS IS" BASIS, WITHOUT WARRANTIES OR CONDITIONS OF ANY KIND, either express or implied. See the License for the specific language governing permissions and limitations under the License.
