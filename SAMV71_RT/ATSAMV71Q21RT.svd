# ATSAMV71Q21RT register map
Vendor: Microchip Technology; Series: SAMV71; File version: 0
Microchip ATSAMV71Q21RT Microcontroller
CPU: CM7 r1p1, little endian, MPU, FPU, double-precision FPU, I-cache, D-cache, ITCM, DTCM, 3 interrupt priority bits, 74 interrupts
Registers are 32-bit, read-write, reset 0x0 unless marked. A register's access mark holds for its fields unless they carry their own. Offsets are from the block's base; lines under a group give offsets from that group; [hi:lo] are bit positions; {n}, {i} and the like mark numbered series; 'fields as' and 'values as' point back to an identical list; <NAME> marks a mode.

## Memory map
0x00000000 LOCKBIT size 0x10
0x40000000 HSMCI size 0x600 — High Speed MultiMedia Card Interface
0x40004000 SSC size 0xEC — Synchronous Serial Controller
0x40008000 SPI0 size 0xEC — Serial Peripheral Interface
0x4000C000 TC0 size 0xE8 — Timer Counter
0x40010000 TC1 size 0xE8
0x40014000 TC2 size 0xE8
0x40018000 TWIHS0 size 0xEC — Two-wire Interface High Speed
0x4001C000 TWIHS1 size 0xEC
0x40020000 PWM0 size 0x464 — Pulse Width Modulation Controller
0x40024000 USART0 size 0xEC — Universal Synchronous Asynchronous Receiver Transmitter
0x40028000 USART1 size 0xEC
0x4002C000 USART2 size 0xEC
0x40030000 MCAN0 size 0xFC — Controller Area Network
0x40034000 MCAN1 size 0xFC
0x40038000 USBHS size 0x810 — USB High-Speed Interface
0x4003C000 AFEC0 size 0xEC — Analog Front-End Controller
0x40040000 DACC size 0xEC — Digital-to-Analog Converter Controller
0x40044000 ACC size 0xEC — Analog Comparator Controller
0x40048000 ICM size 0x58 — Integrity Check Monitor
0x4004C000 ISI size 0xEC — Image Sensor Interface
0x40050000 GMAC size 0x7C0 — Gigabit Ethernet MAC
0x40054000 TC3 size 0xE8
0x40058000 SPI1 size 0xEC
0x4005C000 PWM1 size 0x464
0x40060000 TWIHS2 size 0xEC
0x40064000 AFEC1 size 0xEC
0x40068000 MLB size 0x3E0 — MediaLB
0x4006C000 AES size 0xAC — Advanced Encryption Standard
0x40070000 TRNG size 0x54 — True Random Number Generator
0x40078000 XDMAC size 0x650 — Extensible DMA Controller
0x4007C000 QSPI size 0xEC — Quad Serial Peripheral Interface
0x40080000 SMC size 0xEC — Static Memory Controller
0x40084000 SDRAMC size 0x38 — SDRAM Controller
0x40088000 MATRIX size 0x1EC — AHB Bus Matrix
0x4008C000 I2SC0 size 0x28 — Inter-IC Sound Controller
0x40090000 I2SC1 size 0x28
0x400E0400 UTMI size 0x34 — USB Transmitter Interface Macrocell
0x400E0600 PMC size 0x148 — Power Management Controller
0x400E0800 UART0 size 0xE8 — Universal Asynchronous Receiver Transmitter
0x400E0940 CHIPID size 0x8 — Chip Identifier
0x400E0A00 UART1 size 0xE8
0x400E0C00 EFC size 0xE8 — Embedded Flash Controller
0x400E0E00 PIOA size 0x168 — Parallel Input/Output Controller
0x400E1000 PIOB size 0x168
0x400E1200 PIOC size 0x168
0x400E1400 PIOD size 0x168
0x400E1600 PIOE size 0x168
0x400E1800 RSTC size 0xC — Reset Controller
0x400E1810 SUPC size 0xD8 — Supply Controller
0x400E1830 RTT size 0x10 — Real-time Timer
0x400E1850 WDT size 0xC — Watchdog Timer
0x400E1860 RTC size 0x30 — Real-time Clock
0x400E1890 GPBR size 0x20 — General Purpose Backup Registers
0x400E1900 RSWDT size 0xC — Reinforced Safety Watchdog Timer
0x400E1A00 UART2 size 0xE8
0x400E1C00 UART3 size 0xE8
0x400E1E00 UART4 size 0xE8
0xE0000000 ITM size 0xE84 — Instrumentation Trace Macrocell
0xE0001000 DWT size 0x1000 — Data Watchpoint and Trace Register
0xE0002000 FPB size 0x1000 — Flash Patch and Breakpoint
0xE000E000 SCnSCB size 0xC — System control not in SCB
0xE000E010 SysTick size 0x10 — System timer
0xE000E100 NVIC size 0xE04 — Nested Vectored Interrupt Controller
0xE000ED00 SCB size 0x24C — System Control Block
0xE000ED90 MPU size 0x2C — Memory Protection Unit
0xE000EDF0 CoreDebug size 0x100
0xE000EF30 FPU size 0x1C — Floating Point Unit
0xE0040000 TPIU size 0xFD0 — Trace Port Interface Register
0xE0041000 ETM size 0x1000 — Embedded Trace Macrocell

## Interrupts
0 SUPC — Supply Controller
1 RSTC — Reset Controller
2 RTC — Real Time Clock
3 RTT — Real Time Timer
4 WDT — Watchdog Timer
5 PMC — Power Management Controller
6 EFC — Enhanced Embedded Flash Controller
7 UART0
8 UART1
10 PIOA — Parallel I/O Controller A
11 PIOB — Parallel I/O Controller B
12 PIOC — Parallel I/O Controller C
13 USART0
14 USART1
15 USART2
16 PIOD — Parallel I/O Controller D
17 PIOE — Parallel I/O Controller E
18 HSMCI — Multimedia Card Interface
19 TWIHS0 — Two Wire Interface 0 HS
20 TWIHS1 — Two Wire Interface 1 HS
21 SPI0 — Serial Peripheral Interface 0
22 SSC — Synchronous Serial Controller
23 TC0 — Timer/Counter 0
24 TC1 (TC0) — Timer/Counter 1
25 TC2 (TC0) — Timer/Counter 2
26 TC3 (TC1) — Timer/Counter 3
27 TC4 (TC1) — Timer/Counter 4
28 TC5 (TC1) — Timer/Counter 5
29 AFEC0 — Analog Front End 0
30 DACC — Digital To Analog Converter
31 PWM0 — Pulse Width Modulation 0
32 ICM — Integrity Check Monitor
33 ACC — Analog Comparator
34 USBHS — USB Host / Device Controller
35 MCAN0_INT0 (MCAN0) — MCAN Controller 0 Interrupt 0
36 MCAN0_INT1 (MCAN0) — MCAN Controller 0 Interrupt 1
37 MCAN1_INT0 (MCAN1) — MCAN Controller 1 Interrupt 0
38 MCAN1_INT1 (MCAN1) — MCAN Controller 1 Interrupt 1
39 GMAC — Ethernet MAC
40 AFEC1 — Analog Front End 1
41 TWIHS2 — Two Wire Interface 2 HS
42 SPI1 — Serial Peripheral Interface 1
43 QSPI — Quad I/O Serial Peripheral Interface
44 UART2
45 UART3
46 UART4
47 TC6 (TC2) — Timer/Counter 6
48 TC7 (TC2) — Timer/Counter 7
49 TC8 (TC2) — Timer/Counter 8
50 TC9 (TC3) — Timer/Counter 9
51 TC10 (TC3) — Timer/Counter 10
52 TC11 (TC3) — Timer/Counter 11
53 MLB — MediaLB
56 AES
57 TRNG — True Random Generator
58 XDMAC — DMA
59 ISI — Camera Interface
60 PWM1 — Pulse Width Modulation 1
61 FPU — Floating Point Unit
62 SDRAMC — SDRAM Controller
63 RSWDT — Reinforced Secure Watchdog Timer
64 CCW (SCB) — Cache ECC Warning
65 CCF (SCB) — Cache ECC Fault
66 GMAC_Q1 (GMAC) — GMAC Queue 1
67 GMAC_Q2 (GMAC) — GMAC Queue 2
68 IXC (FPU) — Floating Point Unit IXC
69 I2SC0 — Inter-IC Sound controller 0
70 I2SC1 — Inter-IC Sound controller 1
71 GMAC_Q3 (GMAC) — GMAC Queue 3
72 GMAC_Q4 (GMAC) — GMAC Queue 4
73 GMAC_Q5 (GMAC) — GMAC Queue 5

## Licence text in the file
Copyright (c) 2026 Microchip Technology Inc. SPDX-License-Identifier: Apache-2.0 Licensed under the Apache License, Version 2.0 (the "License"); you may not use this file except in compliance with the License. You may obtain a copy of the License at http://www.apache.org/licenses/LICENSE-2.0 Unless required by applicable law or agreed to in writing, software distributed under the License is distributed on an "AS IS" BASIS, WITHOUT WARRANTIES OR CONDITIONS OF ANY KIND, either express or implied. See the License for the specific language governing permissions and limitations under the License.
