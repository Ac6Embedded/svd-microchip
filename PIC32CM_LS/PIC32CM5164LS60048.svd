# PIC32CM5164LS60048 register map
Vendor: Microchip Technology; Series: PIC32CMLS60; File version: 0
Microchip PIC32CM5164LS60048 Microcontroller
CPU: CM23 r0p0, little endian, MPU, no FPU, 2 interrupt priority bits, 71 interrupts
Registers are 32-bit, read-write, reset 0x0 unless marked. A register's access mark holds for its fields unless they carry their own. Offsets are from the block's base; lines under a group give offsets from that group; [hi:lo] are bit positions; {n}, {i} and the like mark numbered series; 'fields as' and 'values as' point back to an identical list; <NAME> marks a mode.

## Memory map
0x40000000 PAC size 0x80 — Peripheral Access Controller
0x40000200 PAC_SEC size 0x80
0x40000400 PM size 0xA — Power Manager
0x40000800 MCLK size 0x20 — Main Clock
0x40000C00 RSTC size 0x1 — Reset Controller
0x40001000 OSCCTRL size 0x55 — Oscillators Control
0x40001400 OSC32KCTRL size 0x20 — 32k Oscillators Control
0x40001800 SUPC size 0x30 — Supply Controller
0x40001C00 GCLK size 0x10C — Generic Clock Generator
0x40002000 WDT size 0xD — Watchdog Timer
0x40002400 RTC size 0x70 — Real-Time Counter
0x40002800 EIC size 0x44 — External Interrupt Controller
0x40002A00 EIC_SEC size 0x44
0x40002C00 FREQM size 0x14 — Frequency Meter
0x40003000 PORT size 0x100 — Port Module
0x40003200 PORT_SEC size 0x100
0x40003400 AC size 0x24 — Analog Comparators
0x41000000 IDAU size 0xE — Implementation Defined Attribution Unit
0x41002000 DSU size 0x2000 — Device Service Unit
0x41002100 DSU_EXT size 0x2000
0x41004000 NVMCTRL size 0x48 — Non-Volatile Memory Controller
0x41005000 NVMCTRL_SEC size 0x48
0x41006000 DMAC size 0x50 — Direct Memory Access Controller
0x4100A000 USB size 0x200 — Universal Serial Bus
0x42000000 EVSYS size 0x1F8 — Event System Interface
0x42000200 EVSYS_SEC size 0x1F8
0x42000400 SERCOM0 size 0x38 — Serial Communication Interface
0x42000800 SERCOM1 size 0x38
0x42000C00 SERCOM2 size 0x38
0x42001000 SERCOM3 size 0x38
0x42001400 SERCOM4 size 0x38
0x42001800 SERCOM5 size 0x38
0x42001C00 TC0 size 0x38 — Basic Timer Counter
0x42002000 TC1 size 0x38
0x42002400 TC2 size 0x38
0x42002800 TCC0 size 0x80 — Timer Counter for Control Applications
0x42002C00 TCC1 size 0x80
0x42003000 TCC2 size 0x80
0x42003400 TCC3 size 0x80
0x42003800 ADC size 0x2E — Analog Digital Converter
0x42003C00 DAC size 0x19 — Digital-to-Analog Converter
0x42004400 TRNG size 0x24 — True Random Generator
0x42004800 CCL size 0x18 — Configurable Custom Logic
0x42004C00 I2S size 0x38 — Inter-IC Sound Interface
0x42005000 OPAMP size 0x11 — Operational Amplifier
0x42005400 TRAM size 0x400 — TrustRAM
0x60000000 PORT_IOBUS size 0x100
0x60000200 PORT_IOBUS_SEC size 0x100
0xE0001000 DWT size 0x1000 — Data Watchpoint and Trace
0xE0002000 FPB size 0x1000 — Flash Patch and Breakpoint
0xE000E000 ICB size 0xC — Implementation Control Block
0xE000E010 SysTick size 0x10 — SysTick Timer
0xE000E100 NVIC size 0x348 — Nested Vectored Interrupt Controller
0xE000ED00 SCB size 0x88 — System Control Block
0xE000ED90 MPU size 0x38 — Memory Protection Unit
0xE000EDF0 CoreDebug size 0x1C — Debug Control Block
0xE000EFB0 DIB size 0x50 — Debug Identification Block
0xE002E000 ICB_NS size 0xC
0xE002E010 SysTick_NS size 0x10
0xE002E100 NVIC_NS size 0x348
0xE002ED00 SCB_NS size 0x88
0xE002ED90 MPU_NS size 0x38
0xE002EDF0 CoreDebug_NS size 0x1C
0xE002EFB0 DIB_NS size 0x50

## Interrupts
0 SYSTEM (MCLK, OSC32KCTRL, OSCCTRL, PM, SUPC) — System peripherals shared interrupt
1 WDT — Watchdog Timer
2 RTC — Real Time Counter
{n+3} EIC_EXTINT_{n} (EIC) (n=0..7) — External Channel {n}
11 EIC_OTHER (EIC) — External Channel 8..X
12 FREQM — Frequency Meter
13 NVMCTRL — Non-Volatile Memory Controller
14 PORT — Port Non-Secure Check
15 DMAC_0 (DMAC) — DMA Channel 0
16 DMAC_1 (DMAC) — DMA Channel 1
17 DMAC_2 (DMAC) — DMA Channel 2
18 DMAC_3 (DMAC) — DMA Channel 3
19 DMAC_OTHER (DMAC) — DMA Channel 4..X
20 USB — Universal Serial Bus
{n+21} EVSYS_{n} (EVSYS) (n=0..7) — Event System Channel {n}
29 EVSYS_NSCHK (EVSYS) — Event System Non-Secure Check
30 PAC — Peripheral Access Controller
31 SERCOM0_0 (SERCOM0) — Serial Communication Interface 0
32 SERCOM0_1 (SERCOM0) — Serial Communication Interface 0
33 SERCOM0_2 (SERCOM0) — Serial Communication Interface 0
34 SERCOM0_OTHER (SERCOM0) — Serial Communication Interface 0
35 SERCOM1_0 (SERCOM1) — Serial Communication Interface 1
36 SERCOM1_1 (SERCOM1) — Serial Communication Interface 1
37 SERCOM1_2 (SERCOM1) — Serial Communication Interface 1
38 SERCOM1_OTHER (SERCOM1) — Serial Communication Interface 1
39 SERCOM2_0 (SERCOM2) — Serial Communication Interface 2
40 SERCOM2_1 (SERCOM2) — Serial Communication Interface 2
41 SERCOM2_2 (SERCOM2) — Serial Communication Interface 2
42 SERCOM2_OTHER (SERCOM2) — Serial Communication Interface 2
43 SERCOM3_0 (SERCOM3) — Serial Communication Interface 3
44 SERCOM3_1 (SERCOM3) — Serial Communication Interface 3
45 SERCOM3_2 (SERCOM3) — Serial Communication Interface 3
46 SERCOM3_OTHER (SERCOM3) — Serial Communication Interface 3
47 SERCOM4_0 (SERCOM4) — Serial Communication Interface 4
48 SERCOM4_1 (SERCOM4) — Serial Communication Interface 4
49 SERCOM4_2 (SERCOM4) — Serial Communication Interface 4
50 SERCOM4_OTHER (SERCOM4) — Serial Communication Interface 4
51 SERCOM5_0 (SERCOM5) — Serial Communication Interface 5
52 SERCOM5_1 (SERCOM5) — Serial Communication Interface 5
53 SERCOM5_2 (SERCOM5) — Serial Communication Interface 5
54 SERCOM5_OTHER (SERCOM5) — Serial Communication Interface 5
55 TC0 — Timer Counter 0
56 TC1 — Timer Counter 1
57 TC2 — Timer Counter 2
58 TCC0 — TCC Match/Compare 0
59 TCC1 — TCC Match/Compare 1
60 TCC2 — TCC Match/Compare 2
61 TCC3 — TCC Match/Compare 3
62 ADC_OTHER (ADC) — Analog To Digital Converter
63 ADC_RESRDY (ADC) — ADC Result Ready
64 AC — Analog Comparator
65 DAC_UNDERRUN (DAC) — Digital to Analog Converter
66 DAC_EMPTY (DAC) — DAC Buffer 0 Empty
68 TRNG — True Random Generator
69 I2S — Inter-IC Sound Interface
70 TRAM — Trust Ram

## Licence text in the file
Copyright (c) 2026 Microchip Technology Inc. SPDX-License-Identifier: Apache-2.0 Licensed under the Apache License, Version 2.0 (the "License"); you may not use this file except in compliance with the License. You may obtain a copy of the License at http://www.apache.org/licenses/LICENSE-2.0 Unless required by applicable law or agreed to in writing, software distributed under the License is distributed on an "AS IS" BASIS, WITHOUT WARRANTIES OR CONDITIONS OF ANY KIND, either express or implied. See the License for the specific language governing permissions and limitations under the License.
