# PIC32CX2051BZ62132 register map
Vendor: Microchip Technology; Series: PIC32CXBZ62; File version: 0
CPU: CM4 r0p1, little endian, MPU, FPU, 3 interrupt priority bits, 58 interrupts
Registers are 32-bit, read-write, reset 0x0 unless marked. A register's access mark holds for its fields unless they carry their own. Offsets are from the block's base; [hi:lo] are bit positions; {n}, {i} and the like mark numbered series; 'fields as' and 'values as' point back to an identical list.

## PPS
Base 0x44001000
0x00 EXTINT0R
  [4:0] EXTINT0
    0=OFF; 1=RPA0; 2=RPA6; 3=RPA11; 4=RPB0; 5=RPB6; 6=RPB11; 7=RPC0; 8=RPD6; 9=RPE0; 10=RPE6; 11=RPB1; 12=RPC9; 13=RPD3; 14=RPE4; 15=RPA3; 16=RPA7; 17=RPB4; 18=RPB8; 19=RPB12; 20=RPA2; 21=RPA10; 22=RPA14; 23=RPB3; 24=RPB7; 25=RPA9
0x04 EXTINT1R
  [4:0] EXTINT1
    0=OFF; 1=RPA1; 2=RPA7; 3=RPA12; 4=RPB1; 5=RPB7; 6=RPC1; 7=RPC7; 8=RPD7; 9=RPE1; 10=RPA3; 11=RPB2; 12=RPC0; 13=RPD4; 14=RPE6; 15=RPA4; 16=RPA8; 17=RPB12; 18=RPB5; 19=RPB9; 20=RPB13; 21=RPB0; 22=RPB4; 23=RPB8; 24=RPA0; 25=RPA11
0x08 EXTINT2R
  [4:0] EXTINT2
    0=OFF; 1=RPA2; 2=RPA8; 3=RPA13; 4=RPB2; 5=RPB8; 6=RPB13; 7=RPC8; 8=RPD2; 9=RPE2; 10=RPA4; 11=RPB3; 12=RPC1; 13=RPD6; 14=RPE0; 15=RPA5; 16=RPA9; 17=RPB6; 18=RPB10; 19=RPA0; 20=RPB1; 21=RPB5; 22=RPB9; 23=RPA1; 24=RPA12
0x0C EXTINT3R
  [4:0] EXTINT3
    0=OFF; 1=RPA3; 2=RPA9; 3=RPA14; 4=RPB3; 5=RPC9; 6=RPD3; 7=RPE3; 8=RPA0; 9=RPB4; 10=RPC7; 11=RPD7; 12=RPE1; 13=RPA6; 14=RPA10; 15=RPB7; 16=RPB11; 17=RPA1; 18=RPA5; 19=RPA13; 20=RPB2; 21=RPB6; 22=RPB10; 23=RPA8; 24=RPA2
0x3C NMIR
  [4:0] NMI
    values as EXTINT3R.EXTINT3
0x40 SCOM0P0R
  [4:0] SCOM0P0 — SERCOM0/PAD0
    values as EXTINT1R.EXTINT1
{0x44+0x10*i} SCOM{i}P1R (i=0..5)
  [4:0] SCOM{i}P1 — SERCOM{i}/PAD1
    0=OFF; 1=RPA5; 2=RPB5; 3=RPB9; 4=RPD5; 5=RPE5; 6=RPA3; 7=RPA6; 8=RPA7; 9=RPB6; 10=RPB8
0x48 SCOM0P2R
  [4:0] SCOM0P2 — SERCOM0/PAD2
    values as EXTINT3R.EXTINT3
0x4C SCOM0P3R
  [4:0] SCOM0P3 — SERCOM0/PAD3
    values as EXTINT0R.EXTINT0
0x50 SCOM1P0R
  [4:0] SCOM1P0 — SERCOM1/PAD0
    values as EXTINT2R.EXTINT2
0x58 SCOM1P2R
  [4:0] SCOM1P2 — SERCOM1/PAD2
    values as EXTINT0R.EXTINT0
0x5C SCOM1P3R
  [4:0] SCOM1P3 — SERCOM1/PAD3
    values as EXTINT1R.EXTINT1
0x60 SCOM2P0R
  [4:0] SCOM2P0 — SERCOM2/PAD0
    values as EXTINT1R.EXTINT1
0x68 SCOM2P2R
  [4:0] SCOM2P2 — SERCOM2/PAD2
    values as EXTINT3R.EXTINT3
0x6C SCOM2P3R
  [4:0] SCOM2P3 — SERCOM2/PAD3
    values as EXTINT0R.EXTINT0
0x70 SCOM3P0R
  [4:0] SCOM3P0 — SERCOM3/PAD0
    values as EXTINT2R.EXTINT2
0x78 SCOM3P2R
  [4:0] SCOM3P2 — SERCOM3/PAD2
    values as EXTINT0R.EXTINT0
0x7C SCOM3P3R
  [4:0] SCOM3P3 — SERCOM3/PAD3
    values as EXTINT1R.EXTINT1
0x80 SCOM4P0R
  [4:0] SCOM4P0 — SERCOM4/PAD0
    values as EXTINT1R.EXTINT1
0x88 SCOM4P2R
  [4:0] SCOM4P2 — SERCOM4/PAD2
    values as EXTINT3R.EXTINT3
0x8C SCOM4P3R
  [4:0] SCOM4P3 — SERCOM4/PAD3
    values as EXTINT0R.EXTINT0
0x90 SCOM5P0R
  [4:0] SCOM5P0 — SERCOM5/PAD0
    values as EXTINT2R.EXTINT2
0x98 SCOM5P2R
  [4:0] SCOM5P2 — SERCOM5/PAD2
    values as EXTINT0R.EXTINT0
0x9C SCOM5P3R
  [4:0] SCOM5P3 — SERCOM5/PAD3
    values as EXTINT1R.EXTINT1
0xA0 QD0R
  [4:0] QD0
    values as EXTINT3R.EXTINT3
0xA4 QD1R
  [4:0] QD1
    values as EXTINT0R.EXTINT0
0xA8 QD2R
  [4:0] QD2
    values as EXTINT1R.EXTINT1
0xAC QD3R
  [4:0] QD3
    values as EXTINT2R.EXTINT2
0xB0 REFIR
  [4:0] REFI
    values as SCOM0P1R.SCOM{i}P1
0xB4 CCLIN0R
  [4:0] CCLIN0
    values as EXTINT0R.EXTINT0
0xB8 CCLIN1R
  [4:0] CCLIN1
    values as EXTINT1R.EXTINT1
0xBC CCLIN2R
  [4:0] CCLIN2
    values as EXTINT2R.EXTINT2
0xC0 CCLIN3R
  [4:0] CCLIN3
    values as EXTINT0R.EXTINT0
0xC4 CCLIN4R
  [4:0] CCLIN4
    values as EXTINT1R.EXTINT1
0xC8 CCLIN5R
  [4:0] CCLIN5
    values as EXTINT2R.EXTINT2
{0xCC+0x10*i} TC{i}WO0G1R (i=0..8)
  [4:0] TC{i}WO0G1
    values as EXTINT0R.EXTINT0
0xD0 TC0WO0G2R
  [4:0] TC0WO0G2
    values as EXTINT1R.EXTINT1
0xD4 TC0WO1G3R
  [4:0] TC0WO1G3
    values as EXTINT2R.EXTINT2
0xD8 TC0WO1G4R
  [4:0] TC0WO1G4
    values as EXTINT3R.EXTINT3
{0xD4+0x10*i} TC{i}WO1G2R (i=1..8)
  [4:0] TC{i}WO1G2
    values as EXTINT1R.EXTINT1
{0xD0+0x10*i} TC{i}WO0G3R (i=2..8)
  [4:0] TC{i}WO0G3
    values as EXTINT2R.EXTINT2
{0xD8+0x10*i} TC{i}WO1G4R (i=2..7)
  [4:0] TC{i}WO1G4
    values as EXTINT3R.EXTINT3
0x158 TC8WO1G5R
  [4:0] TC8WO1G5
    0=OFF; 1=RPA4; 2=RPA10; 3=RPB4; 4=RPB10; 5=RPD4; 6=RPE4; 7=RPA1; 8=RPB0; 9=RPC8; 10=RPD2; 11=RPE2; 12=RPC10; 13=RPC11; 14=RPA15; 15=RPB14; 16=RPB15; 17=RPD0; 18=RPD1
0x15C TC9WO0G2R
  [4:0] TC9WO0G2
    values as EXTINT1R.EXTINT1
0x160 TC9WO0G4R
  [4:0] TC9WO0G4
    values as EXTINT3R.EXTINT3
0x164 TC9WO1G3R
  [4:0] TC9WO1G3
    values as EXTINT2R.EXTINT2
0x168 TC9WO1G5R
  [4:0] TC9WO1G5
    values as TC8WO1G5R.TC8WO1G5
0x16C QEIHOME0G1R
  [4:0] QEIHOME0G1
    values as EXTINT0R.EXTINT0
0x170 QEIHOME0G2R
  [4:0] QEIHOME0G2
    values as EXTINT1R.EXTINT1
0x174 QEIINDX0G2R
  [4:0] QEIINDX0G2
    values as EXTINT1R.EXTINT1
0x178 QEIINDX0G3R
  [4:0] QEIINDX0G3
    values as EXTINT2R.EXTINT2
0x17C QEIQEA0G3R
  [4:0] QEIQEA0G3
    values as EXTINT2R.EXTINT2
0x180 QEIQEA0G4R
  [4:0] QEIQEA0G4
    values as EXTINT3R.EXTINT3
0x184 QEIQEB0G4R
  [4:0] QEIQEB0G4
    values as EXTINT3R.EXTINT3
0x188 QEIQEB0G5R
  [4:0] QEIQEB0G5
    values as TC8WO1G5R.TC8WO1G5
0x18C ACCMPTENR
  [4:0] ACCMPTEN
    values as EXTINT0R.EXTINT0
0x190 CAN1RXR
  [4:0] CAN1RX
    values as EXTINT2R.EXTINT2
0x194 COEXWLANACTR
  [4:0] COEXWLANACT
    values as EXTINT3R.EXTINT3
0x200 RPA0G1R
  [5:0] RPA0G1R — RPA0/G1
    0=OFF; 1=SCOM0P3 (SERCOM0/PAD3); 2=SCOM0P2 (SERCOM0/PAD2); 3=SCOM1P0 (SERCOM1/PAD0); 4=SCOM1P2 (SERCOM1/PAD2); 5=SCOM2P3 (SERCOM2/PAD3); 6=SCOM2P2 (SERCOM2/PAD2); 7=SCOM3P0 (SERCOM3/PAD0); 8=SCOM3P2 (SERCOM3/PAD2); 9=SCOM4P3 (SERCOM4/PAD3); 10=SCOM4P2 (SERCOM4/PAD2); 11=SCOM5P0 (SERCOM5/PAD0); 12=SCOM5P2 (SERCOM5/PAD2); 13=TCC0WO0; 14=TCC0WO4; 15=TCC1WO0; 16=TCC1WO4; 17=TCC2WO0; 18=TC0WO1; {v}=TC{v-18}WO0 (v=19..26); 27=QSPICS; 28=QD3 (QSPI/DATA3); 29=QD2 (QSPI/DATA2); 30=QD1 (QSPI/DATA1); 31=QEICCMP0; 32=TSTBUS0; 33=TSTBUS4; 34=TSTBUS8; 35=FECTRL1; 36=FECTRL2; 37=COEX_BT_STATE
0x204 RPA0G2R
  [5:0] RPA0G2R — RPA0/G2
    0=OFF; 1=CCLO1 (CCL/OUT1); 2=SCOM0P0 (SERCOM0/PAD0); 3=SCOM0P3 (SERCOM0/PAD3); 4=SCOM0P2 (SERCOM0/PAD2); 5=SCOM1P3 (SERCOM1/PAD3); 6=SCOM1P2 (SERCOM1/PAD2); 7=SCOM2P0 (SERCOM2/PAD0); 8=SCOM2P3 (SERCOM2/PAD3); 9=SCOM2P2 (SERCOM2/PAD2); 10=SCOM3P3 (SERCOM3/PAD3); 11=SCOM3P2 (SERCOM3/PAD2); 12=SCOM4P0 (SERCOM4/PAD0); 13=SCOM4P3 (SERCOM4/PAD3); 14=SCOM4P2 (SERCOM4/PAD2); 15=SCOM5P3 (SERCOM5/PAD3); 16=SCOM5P2 (SERCOM5/PAD2); 17=TCC0WO1; 18=TCC0WO5; 19=TCC0WO3; 20=TCC1WO1; 21=TCC1WO5; 22=TCC1WO3; 23=TCC2WO1; {v}=TC{v-24}WO1 (v=24..32); 33=TC9WO0; 34=QSPICS; 35=QD0 (QSPI/DATA0); 36=QD3 (QSPI/DATA3); 37=QD2 (QSPI/DATA2); 38=TSTBUS5; 39=TSTBUS9; 40=FECTRL0; 41=COEX_RF_ACT
0x208 RPA0G3R
  [5:0] RPA0G3R — RPA0/G3
    0=OFF; 1=CCLO0 (CCL/OUT0); 2=SCOM0P0 (SERCOM0/PAD0); 3=SCOM0P3 (SERCOM0/PAD3); 4=SCOM1P2 (SERCOM1/PAD2); 5=SCOM1P0 (SERCOM1/PAD0); 6=SCOM1P3 (SERCOM1/PAD3); 7=SCOM2P0 (SERCOM2/PAD0); 8=SCOM2P3 (SERCOM2/PAD3); 9=SCOM3P2 (SERCOM3/PAD2); 10=SCOM3P0 (SERCOM3/PAD0); 11=SCOM3P3 (SERCOM3/PAD3); 12=SCOM4P0 (SERCOM4/PAD0); 13=SCOM4P3 (SERCOM4/PAD3); 14=SCOM5P2 (SERCOM5/PAD2); 15=SCOM5P0 (SERCOM5/PAD0); 16=SCOM5P3 (SERCOM5/PAD3); 17=TCC0WO2; 18=TCC0WO0; 19=TCC0WO4; 20=TCC1WO2; 21=TCC1WO0; 22=TCC1WO4; 23=TCC2WO0; {v}=TC{v-24}WO0 (v=24..32); 33=TC9WO1; 34=QSPICS; 35=QD1 (QSPI/DATA1); 36=QD0 (QSPI/DATA0); 37=QD3 (QSPI/DATA3); 38=TSTBUS1; 39=TSTBUS10; 40=AC_CMP0; 41=AC_CMPTRDY; 42=FECTRL4
0x20C RPA0G4R
  [5:0] RPA0G4R — RPA0/G4
    0=OFF; 1=CCLO1 (CCL/OUT1); 2=SCOM0P2 (SERCOM0/PAD2); 3=SCOM0P0 (SERCOM0/PAD0); 4=SCOM1P3 (SERCOM1/PAD3); 5=SCOM1P0 (SERCOM1/PAD0); 6=SCOM2P2 (SERCOM2/PAD2); 7=SCOM2P0 (SERCOM2/PAD0); 8=SCOM3P3 (SERCOM3/PAD3); 9=SCOM3P0 (SERCOM3/PAD0); 10=SCOM4P2 (SERCOM4/PAD2); 11=SCOM4P0 (SERCOM4/PAD0); 12=SCOM5P3 (SERCOM5/PAD3); 13=SCOM5P0 (SERCOM5/PAD0); 14=TCC0WO3; 15=TCC0WO1; 16=TCC0WO5; 17=TCC1WO3; 18=TCC1WO1; 19=TCC1WO5; 20=TCC2WO1; 21=TC0WO0; {v}=TC{v-21}WO1 (v=22..28); 29=TC9WO0; 30=QSPICS; 31=QD2 (QSPI/DATA2); 32=QD1 (QSPI/DATA1); 33=QD0 (QSPI/DATA0); 34=TSTBUS2; 35=TSTBUS6; 36=AC_CMP1; 37=AC_CMPTOUT; 38=CAN1_TX; 39=FECTRL3; 40=FECTRL5
0x210 RPA1G2R
  [5:0] RPA1G2R — RPA1/G2
    values as RPA0G2R.RPA0G2R
0x214 RPA1G3R
  [5:0] RPA1G3R — RPA1/G3
    values as RPA0G3R.RPA0G3R
0x218 RPA1G4R
  [5:0] RPA1G4R — RPA1/G4
    values as RPA0G4R.RPA0G4R
0x21C RPA1G5R
  [5:0] RPA1G5R — RPA1/G5
    0=OFF; 1=CCLO0 (CCL/OUT0); 2=SCOM1P3 (SERCOM1/PAD3); 3=SCOM2P0 (SERCOM2/PAD0); 4=TCC0WO4; 5=TCC0WO2; 6=TCC0WO1; 7=TCC1WO4; 8=TCC1WO2; 9=TCC1WO1; 10=TC8WO1; 11=TC9WO1; 12=QSPICS; 13=QEICCMP0; 14=GMAC_TSUCOMP (ETH/TSUCOMP); 15=TSTBUS3; 16=TSTBUS7; 17=TSTBUS11
0x220 RPA2G1R
  [5:0] RPA2G1R — RPA2/G1
    values as RPA0G1R.RPA0G1R
0x224 RPA2G3R
  [5:0] RPA2G3R — RPA2/G3
    values as RPA0G3R.RPA0G3R
0x228 RPA2G4R
  [5:0] RPA2G4R — RPA2/G4
    values as RPA0G4R.RPA0G4R
0x22C RPA3G1R
  [5:0] RPA3G1R — RPA3/G1
    values as RPA0G1R.RPA0G1R
0x230 RPA3G2R
  [5:0] RPA3G2R — RPA3/G2
    values as RPA0G2R.RPA0G2R
0x234 RPA3G4R
  [5:0] RPA3G4R — RPA3/G4
    values as RPA0G4R.RPA0G4R
0x238 RPA3G6R
  [5:0] RPA3G6R — RPA3/G6
    0=OFF; {v}=SCOM{v-1}P1 (SERCOM{v-1}/PAD1) (v=1..6); 7=QSPI_SCK; {v}=REFO{v-7} (v=8..11)
0x23C RPA4G2R
  [5:0] RPA4G2R — RPA4/G2
    values as RPA0G2R.RPA0G2R
0x240 RPA4G3R
  [5:0] RPA4G3R — RPA4/G3
    values as RPA0G3R.RPA0G3R
0x244 RPA4G5R
  [5:0] RPA4G5R — RPA4/G5
    values as RPA1G5R.RPA1G5R
0x248 RPA5G3R
  [5:0] RPA5G3R — RPA5/G3
    values as RPA0G3R.RPA0G3R
0x24C RPA5G4R
  [5:0] RPA5G4R — RPA5/G4
    values as RPA0G4R.RPA0G4R
{0x214+0xC*i} RPA{i}G6R (i=5..7)
  [5:0] RPA{i}G6R — RPA{i}/G6
    values as RPA3G6R.RPA3G6R
0x254 RPA6G1R
  [5:0] RPA6G1R — RPA6/G1
    values as RPA0G1R.RPA0G1R
0x258 RPA6G4R
  [5:0] RPA6G4R — RPA6/G4
    values as RPA0G4R.RPA0G4R
0x260 RPA7G1R
  [5:0] RPA7G1R — RPA7/G1
    values as RPA0G1R.RPA0G1R
0x264 RPA7G2R
  [5:0] RPA7G2R — RPA7/G2
    values as RPA0G2R.RPA0G2R
0x26C RPA8G2R
  [5:0] RPA8G2R — RPA8/G2
    values as RPA0G2R.RPA0G2R
0x270 RPA8G3R
  [5:0] RPA8G3R — RPA8/G3
    values as RPA0G3R.RPA0G3R
0x274 RPA8G4R
  [5:0] RPA8G4R — RPA8/G4
    values as RPA0G4R.RPA0G4R
0x278 RPA9G1R
  [5:0] RPA9G1R — RPA9/G1
    values as RPA0G1R.RPA0G1R
0x27C RPA9G3R
  [5:0] RPA9G3R — RPA9/G3
    values as RPA0G3R.RPA0G3R
0x280 RPA9G4R
  [5:0] RPA9G4R — RPA9/G4
    values as RPA0G4R.RPA0G4R
0x284 RPA10G1R
  [5:0] RPA10G1R — RPA10/G1
    values as RPA0G1R.RPA0G1R
0x288 RPA10G4R
  [5:0] RPA10G4R — RPA10/G4
    values as RPA0G4R.RPA0G4R
0x28C RPA10G5R
  [5:0] RPA10G5R — RPA10/G5
    values as RPA1G5R.RPA1G5R
0x2A0 RPA13G3R
  [5:0] RPA13G3R — RPA13/G3
    values as RPA0G3R.RPA0G3R
0x2A4 RPA13G4R
  [5:0] RPA13G4R — RPA13/G4
    values as RPA0G4R.RPA0G4R
0x2A8 RPA14G1R
  [5:0] RPA14G1R — RPA14/G1
    values as RPA0G1R.RPA0G1R
0x2AC RPA14G4R
  [5:0] RPA14G4R — RPA14/G4
    values as RPA0G4R.RPA0G4R
0x2B0 RPA15G5R
  [5:0] RPA15G5R — RPA15/G5
    values as RPA1G5R.RPA1G5R
0x2B4 RPB0G1R
  [5:0] RPB0G1R — RPB0/G1
    values as RPA0G1R.RPA0G1R
0x2B8 RPB0G2R
  [5:0] RPB0G2R — RPB0/G2
    values as RPA0G2R.RPA0G2R
0x2BC RPB0G5R
  [5:0] RPB0G5R — RPB0/G5
    values as RPA1G5R.RPA1G5R
0x2C0 RPB1G1R
  [5:0] RPB1G1R — RPB1/G1
    values as RPA0G1R.RPA0G1R
0x2C4 RPB1G2R
  [5:0] RPB1G2R — RPB1/G2
    values as RPA0G2R.RPA0G2R
0x2C8 RPB1G3R
  [5:0] RPB1G3R — RPB1/G3
    values as RPA0G3R.RPA0G3R
0x2CC RPB2G2R
  [5:0] RPB2G2R — RPB2/G2
    values as RPA0G2R.RPA0G2R
0x2D0 RPB2G3R
  [5:0] RPB2G3R — RPB2/G3
    values as RPA0G3R.RPA0G3R
{0x2BC+0xC*i} RPB{i}G4R (i=2..4)
  [5:0] RPB{i}G4R — RPB{i}/G4
    values as RPA0G4R.RPA0G4R
0x2D8 RPB3G1R
  [5:0] RPB3G1R — RPB3/G1
    values as RPA0G1R.RPA0G1R
0x2DC RPB3G3R
  [5:0] RPB3G3R — RPB3/G3
    values as RPA0G3R.RPA0G3R
0x2E4 RPB4G1R
  [5:0] RPB4G1R — RPB4/G1
    values as RPA0G1R.RPA0G1R
0x2E8 RPB4G2R
  [5:0] RPB4G2R — RPB4/G2
    values as RPA0G2R.RPA0G2R
0x2F0 RPB4G5R
  [5:0] RPB4G5R — RPB4/G5
    values as RPA1G5R.RPA1G5R
0x2F4 RPB5G2R
  [5:0] RPB5G2R — RPB5/G2
    values as RPA0G2R.RPA0G2R
0x2F8 RPB5G3R
  [5:0] RPB5G3R — RPB5/G3
    values as RPA0G3R.RPA0G3R
0x2FC RPB5G6R
  [5:0] RPB5G6R — RPB5/G6
    values as RPA3G6R.RPA3G6R
0x300 RPB6G1R
  [5:0] RPB6G1R — RPB6/G1
    values as RPA0G1R.RPA0G1R
0x304 RPB6G3R
  [5:0] RPB6G3R — RPB6/G3
    values as RPA0G3R.RPA0G3R
0x308 RPB6G4R
  [5:0] RPB6G4R — RPB6/G4
    values as RPA0G4R.RPA0G4R
0x30C RPB6G6R
  [5:0] RPB6G6R — RPB6/G6
    values as RPA3G6R.RPA3G6R
0x310 RPB7G1R
  [5:0] RPB7G1R — RPB7/G1
    values as RPA0G1R.RPA0G1R
{0x2C0+0xC*i} RPB{i}G2R (i=7..9)
  [5:0] RPB{i}G2R — RPB{i}/G2
    values as RPA0G2R.RPA0G2R
0x318 RPB7G4R
  [5:0] RPB7G4R — RPB7/G4
    values as RPA0G4R.RPA0G4R
0x31C RPB8G1R
  [5:0] RPB8G1R — RPB8/G1
    values as RPA0G1R.RPA0G1R
0x324 RPB8G3R
  [5:0] RPB8G3R — RPB8/G3
    values as RPA0G3R.RPA0G3R
0x328 RPB8G6R
  [5:0] RPB8G6R — RPB8/G6
    values as RPA3G6R.RPA3G6R
0x330 RPB9G3R
  [5:0] RPB9G3R — RPB9/G3
    values as RPA0G3R.RPA0G3R
0x334 RPB9G6R
  [5:0] RPB9G6R — RPB9/G6
    values as RPA3G6R.RPA3G6R
0x338 RPB10G3R
  [5:0] RPB10G3R — RPB10/G3
    values as RPA0G3R.RPA0G3R
0x33C RPB10G4R
  [5:0] RPB10G4R — RPB10/G4
    values as RPA0G4R.RPA0G4R
0x340 RPB10G5R
  [5:0] RPB10G5R — RPB10/G5
    values as RPA1G5R.RPA1G5R
0x344 RPB11G1R
  [5:0] RPB11G1R — RPB11/G1
    values as RPA0G1R.RPA0G1R
0x348 RPB11G4R
  [5:0] RPB11G4R — RPB11/G4
    values as RPA0G4R.RPA0G4R
0x34C RPB12G1R
  [5:0] RPB12G1R — RPB12/G1
    values as RPA0G1R.RPA0G1R
0x350 RPB12G2R
  [5:0] RPB12G2R — RPB12/G2
    values as RPA0G2R.RPA0G2R
0x354 RPB13G2R
  [5:0] RPB13G2R — RPB13/G2
    values as RPA0G2R.RPA0G2R
0x358 RPB13G3R
  [5:0] RPB13G3R — RPB13/G3
    values as RPA0G3R.RPA0G3R
0x35C RPB14G5R
  [5:0] RPB14G5R — RPB14/G5
    values as RPA1G5R.RPA1G5R
0x360 RPB15G5R
  [5:0] RPB15G5R — RPB15/G5
    values as RPA1G5R.RPA1G5R
0x364 RPC0G1R
  [5:0] RPC0G1R — RPC0/G1
    values as RPA0G1R.RPA0G1R
0x368 RPC0G2R
  [5:0] RPC0G2R — RPC0/G2
    values as RPA0G2R.RPA0G2R
0x36C RPC1G2R
  [5:0] RPC1G2R — RPC1/G2
    values as RPA0G2R.RPA0G2R
0x370 RPC1G3R
  [5:0] RPC1G3R — RPC1/G3
    values as RPA0G3R.RPA0G3R
0x388 RPC7G2R
  [5:0] RPC7G2R — RPC7/G2
    values as RPA0G2R.RPA0G2R
0x38C RPC7G4R
  [5:0] RPC7G4R — RPC7/G4
    values as RPA0G4R.RPA0G4R
0x390 RPC8G3R
  [5:0] RPC8G3R — RPC8/G3
    values as RPA0G3R.RPA0G3R
0x394 RPC8G5R
  [5:0] RPC8G5R — RPC8/G5
    values as RPA1G5R.RPA1G5R
0x398 RPC9G1R
  [5:0] RPC9G1R — RPC9/G1
    values as RPA0G1R.RPA0G1R
0x39C RPC9G4R
  [5:0] RPC9G4R — RPC9/G4
    values as RPA0G4R.RPA0G4R
0x3A0 RPC10G5R
  [5:0] RPC10G5R — RPC10/G5
    values as RPA1G5R.RPA1G5R
0x3A4 RPC11G5R
  [5:0] RPC11G5R — RPC11/G5
    values as RPA1G5R.RPA1G5R
0x3B8 RPD0G5R
  [5:0] RPD0G5R — RPD0/G5
    values as RPA1G5R.RPA1G5R
0x3BC RPD1G5R
  [5:0] RPD1G5R — RPD1/G5
    values as RPA1G5R.RPA1G5R
0x3C0 RPD2G3R
  [5:0] RPD2G3R — RPD2/G3
    values as RPA0G3R.RPA0G3R
0x3C4 RPD2G5R
  [5:0] RPD2G5R — RPD2/G5
    values as RPA1G5R.RPA1G5R
0x3C8 RPD3G1R
  [5:0] RPD3G1R — RPD3/G1
    values as RPA0G1R.RPA0G1R
0x3CC RPD3G4R
  [5:0] RPD3G4R — RPD3/G4
    values as RPA0G4R.RPA0G4R
0x3D0 RPD4G2R
  [5:0] RPD4G2R — RPD4/G2
    values as RPA0G2R.RPA0G2R
0x3D4 RPD4G5R
  [5:0] RPD4G5R — RPD4/G5
    values as RPA1G5R.RPA1G5R
0x3D8 RPD5G6R
  [5:0] RPD5G6R — RPD5/G6
    values as RPA3G6R.RPA3G6R
0x3DC RPD6G1R
  [5:0] RPD6G1R — RPD6/G1
    values as RPA0G1R.RPA0G1R
0x3E0 RPD6G3R
  [5:0] RPD6G3R — RPD6/G3
    values as RPA0G3R.RPA0G3R
0x3E4 RPD7G2R
  [5:0] RPD7G2R — RPD7/G2
    values as RPA0G2R.RPA0G2R
0x3E8 RPD7G4R
  [5:0] RPD7G4R — RPD7/G4
    values as RPA0G4R.RPA0G4R
0x40C RPE0G1R
  [5:0] RPE0G1R — RPE0/G1
    values as RPA0G1R.RPA0G1R
0x410 RPE0G3R
  [5:0] RPE0G3R — RPE0/G3
    values as RPA0G3R.RPA0G3R
0x414 RPE1G2R
  [5:0] RPE1G2R — RPE1/G2
    values as RPA0G2R.RPA0G2R
0x418 RPE1G4R
  [5:0] RPE1G4R — RPE1/G4
    values as RPA0G4R.RPA0G4R
0x41C RPE2G3R
  [5:0] RPE2G3R — RPE2/G3
    values as RPA0G3R.RPA0G3R
0x420 RPE2G5R
  [5:0] RPE2G5R — RPE2/G5
    values as RPA1G5R.RPA1G5R
0x424 RPE3G4R
  [5:0] RPE3G4R — RPE3/G4
    values as RPA0G4R.RPA0G4R
0x428 RPE4G1R
  [5:0] RPE4G1R — RPE4/G1
    values as RPA0G1R.RPA0G1R
0x42C RPE4G5R
  [5:0] RPE4G5R — RPE4/G5
    values as RPA1G5R.RPA1G5R
0x430 RPE5G6R
  [5:0] RPE5G6R — RPE5/G6
    values as RPA3G6R.RPA3G6R
0x434 RPE6G1R
  [5:0] RPE6G1R — RPE6/G1
    values as RPA0G1R.RPA0G1R
0x438 RPE6G2R
  [5:0] RPE6G2R — RPE6/G2
    values as RPA0G2R.RPA0G2R
