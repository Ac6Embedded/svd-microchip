# SAM9X75D5M register map
Vendor: Microchip Technology; Series: SAM9X7; File version: 0
Microchip SAM9X75D5M Microcontroller
Registers are 32-bit, read-write, reset 0x0 unless marked. A register's access mark holds for its fields unless they carry their own. Offsets are from the block's base; lines under a group give offsets from that group; [hi:lo] are bit positions; {n}, {i} and the like mark numbered series; 'fields as' and 'values as' point back to an identical list; <NAME> marks a mode.

## Memory map
0x00600000 UHPHS_OHCI size 0x60 — USB Host Full-Speed Port
0x00700000 UHPHS size 0xB0 — USB Host High Speed Port
0x80000000 SDMMC0 size 0x238 — Secure Digital MultiMedia Card Controller
0x90000000 SDMMC1 size 0x238
0xEFF00000 OTPC size 0xEC — OTP Memory Controller
0xF0000000 FLEXCOM4 size 0x6EC
0xF0004000 FLEXCOM5 size 0x6EC
0xF0008000 XDMAC size 0x450 — Extensible DMA Controller
0xF0010000 SSC size 0xEC — Synchronous Serial Controller
0xF0014000 QSPI size 0xEC — Quad Serial Peripheral Interface
0xF0018000 GFX2D size 0x80 — 2D Graphics Engine
0xF001C000 I2SMCC size 0xEC — Inter-IC Sound Multi Channel Controller
0xF0020000 FLEXCOM11 size 0x6EC
0xF0024000 FLEXCOM12 size 0x6EC
0xF0028000 PIT64B0 size 0xEC — Periodic Interval Timer 64-bit
0xF002C000 SHA size 0xEC — Secure Hash Algorithm
0xF0030000 TRNG size 0xEC — True Random Number Generator
0xF0034000 AES size 0xEC — Advanced Encryption Standard
0xF0038000 TDES size 0xEC — Triple Data Encryption Standard
0xF003C000 CLASSD size 0xE8 — Audio Class D Amplifier
0xF0040000 PIT64B1 size 0xEC
0xF8000000 MCAN0 size 0x1B4 — Controller Area Network
0xF8004000 MCAN1 size 0x1B4
0xF8008000 TC0 size 0xE8 — Timer Counter
0xF800C000 TC1 size 0xE8
0xF8010000 FLEXCOM6 size 0x6EC
0xF8014000 FLEXCOM7 size 0x6EC
0xF8018000 FLEXCOM8 size 0x6EC
0xF801C000 FLEXCOM0 size 0x6EC — Flexible Serial Communication
0xF8020000 FLEXCOM1 size 0x6EC
0xF8024000 FLEXCOM2 size 0x6EC
0xF8028000 FLEXCOM3 size 0x6EC
0xF802C000 GMAC size 0x1B84 — Gigabit Ethernet MAC
0xF8030000 PUF size 0xF4 — Physical Unclonable Functions
0xF8034000 PWM size 0x280 — Pulse Width Modulation Controller
0xF8038000 XLCDC size 0x1700 — LCD Controller
0xF803C000 UDPHS size 0x370 — IP_Name
0xF8040000 FLEXCOM9 size 0x6EC
0xF8044000 FLEXCOM10 size 0x6EC
0xF8048000 ISC size 0xD5C — Image Sensor Controller
0xF804C000 ADC size 0xEC — Analog-to-Digital Converter
0xF8050000 SFR size 0x264 — Special Function Registers
0xF8054000 DSI size 0x194 — Display Serial Interface
0xF8058000 CSI size 0x314 — CSI Host Controller
0xF805C000 CSI2DC size 0x10C — CSI-2 Demultiplexer Controller
0xF8060000 LVDSC size 0xEC — LVDS Controller
0xFFFFDE00 MATRIX size 0x1EC — AHB Bus Matrix (MATRIX2)
0xFFFFE000 PMECC size 0x440 — IP_Name
0xFFFFE600 PMERRLOC size 0xEC — Programmable Multibit ECC Error Location
0xFFFFE800 MPDDRC size 0xEC — DDR-SDRAM Controller
0xFFFFEA00 SMC size 0xEC — Static Memory Controller
0xFFFFF100 AIC size 0xEC — Advanced Interrupt Controller
0xFFFFF200 DBGU size 0xE8 — Debug Unit
0xFFFFF400 PIOA size 0x11C — Parallel Input/Output Controller
0xFFFFF600 PIOB size 0x11C
0xFFFFF800 PIOC size 0x11C
0xFFFFFA00 PIOD size 0x11C
0xFFFFFC00 PMC size 0xF4 — Power Management Controller
0xFFFFFE00 RSTC size 0xC — Reset Controller
0xFFFFFE10 SHDWC size 0x10 — Shutdown Controller
0xFFFFFE20 RTT size 0x18 — Real-time Timer
0xFFFFFE40 PIT size 0x10 — Periodic Interval Timer
0xFFFFFE50 SCKC size 0x4 — Slow Clock Controller
0xFFFFFE54 BSC size 0x4 — Boot Sequence Controller
0xFFFFFE60 GPBR size 0x28 — General Purpose Backup Registers
0xFFFFFEA8 RTC size 0xC8 — Real-time Clock
0xFFFFFEDC SYSCWP size 0x8 — External Interrupt Controller
0xFFFFFF80 WDT size 0x24 — Watchdog Timer

## Interrupts
0 EXT_FIQ (AIC) — Advanced Interrupt Controller
1 SYSC (PIT, PMC, RSTC, RTC, RTT, WDT) — Logical-OR interrupt of PMC, WDT, PIT, RSTC, RTT, RTC
2 PIOA — Parallel I/O Controller A
3 PIOB — Parallel I/O Controller B
4 PIOC — Parallel I/O Controller C
5 FLEXCOM0
6 FLEXCOM1
7 FLEXCOM2
8 FLEXCOM3
9 FLEXCOM6
10 FLEXCOM7
11 FLEXCOM8
12 SDMMC0 — Secure Data Memory Card Controller 0
13 FLEXCOM4
14 FLEXCOM5
15 FLEXCOM9
16 FLEXCOM10
17 TC0 — TC 0,1,2
18 PWM — Pulse Width Modulation Controller
19 ADC — ADC Controller
20 XDMAC — Extended DMA Controller
21 MATRIX
22 UHPHS — USB Host High Speed
23 UDPHS — USB Device High Speed
24 GMAC — Gigabit Ethernet MAC
25 XLCDC — LCD Controller
26 SDMMC1 — Secure Data Memory Card Controller 1
28 SSC — Synchronous Serial Controller
29 MCAN0_INT0 (MCAN0) — Master CAN 0
30 MCAN1_INT0 (MCAN1) — Master CAN 1
31 EXT_IRQ (AIC) — Advanced Interrupt Controller
32 FLEXCOM11
33 FLEXCOM12
34 I2SMCC — I2S Multi Channel Controller
35 QSPI — Quad I/O SPI Controller
36 GFX2D — 2D Graphic Controller
37 PIT64B0 — 64-b Timer 0
38 TRNG — True Random Number Generator
39 AES — Advanced Encryption Standard
40 TDES — Triple Data Encryption Standard
41 SHA — Secure Hash Algorithm
42 CLASSD — CLASS D Controller
43 ISC — Camera Interface
44 PIOD — Parallel I/O Controller D
45 TC1 — TC 3,4,5
46 OTPC — OTP Controller
47 DBGU
48 ECC (PMECC, PMERRLOC) — logical-OR interrupt of PMECC and PMERRLOC
49 MC (MPDDRC, SMC) — logical-OR interrupt of MPDDRC and SMC
52 CSI2DC — CSI to Demultiplexer Controller
53 CSI — Camera Serial Interface 2 4-Lanes
54 DSI — Display Serial Interface 4-Lanes
56 LVDSC — Display Serial Interface between XLCDC and LVDS interface
58 PIT64B1 — 64-b Timer 1
60 GMAC_Q1 (GMAC) — GMAC Queue 1 Interrupt signal toggled on a DMA write to the first word of each DMA data buffer associated with queue 1
61 GMAC_Q2 (GMAC) — GMAC Queue 2 Interrupt signal toggled on a DMA write to the first word of each DMA data buffer associated with queue 2
62 GMAC_Q3 (GMAC) — GMAC Queue 3 Interrupt signal toggled on a DMA write to the first word of each DMA data buffer associated with queue 3
63 GMAC_Q4 (GMAC) — GMAC Queue 4 Interrupt signal toggled on a DMA write to the first word of each DMA data buffer associated with queue 4
64 GMAC_Q5 (GMAC) — GMAC Queue 5 Interrupt signal toggled on a DMA write to the first word of each DMA data buffer associated with queue 5
65 GMAC_EMAC (GMAC) — Gigabit Ethernet MAC - Express MAC
66 GMAC_MMSL (GMAC) — Gigabit Ethernet MAC - Mac Merge SubLayer
67 GMAC_TSU (GMAC) — Gigabit Ethernet MAC - TSU
68 MCAN0_INT1 (MCAN0) — Master CAN 0 interrupt 1
69 MCAN1_INT1 (MCAN1) — Master CAN 1 interrupt 1

## Licence text in the file
Copyright (c) 2026 Microchip Technology Inc. SPDX-License-Identifier: Apache-2.0 Licensed under the Apache License, Version 2.0 (the "License"); you may not use this file except in compliance with the License. You may obtain a copy of the License at http://www.apache.org/licenses/LICENSE-2.0 Unless required by applicable law or agreed to in writing, software distributed under the License is distributed on an "AS IS" BASIS, WITHOUT WARRANTIES OR CONDITIONS OF ANY KIND, either express or implied. See the License for the specific language governing permissions and limitations under the License.
