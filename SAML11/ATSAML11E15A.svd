# ATSAML11E15A register map
Vendor: Microchip Technology; Series: SAML11; File version: 0
Microchip ATSAML11E15A Microcontroller
CPU: CM23 r0p0, little endian, MPU, no FPU, 2 interrupt priority bits, 45 interrupts
Registers are 32-bit, read-write, reset 0x0 unless marked. A register's access mark holds for its fields unless they carry their own. Offsets are from the block's base; lines under a group give offsets from that group; [hi:lo] are bit positions; {n}, {i} and the like mark numbered series; 'fields as' and 'values as' point back to an identical list; <NAME> marks a mode.

## Memory map
0x40000000 PAC size 0x60 — Peripheral Access Controller
0x40000200 PAC_SEC size 0x60
0x40000400 PM size 0xA — Power Manager
0x40000800 MCLK size 0x20 — Main Clock
0x40000C00 RSTC size 0x1 — Reset Controller
0x40001000 OSCCTRL size 0x41 — Oscillators Control
0x40001400 OSC32KCTRL size 0x20 — 32k Oscillators Control
0x40001800 SUPC size 0x30 — Supply Controller
0x40001C00 GCLK size 0xD4 — Generic Clock Generator
0x40002000 WDT size 0xD — Watchdog Timer
0x40002400 RTC size 0x70 — Real-Time Counter
0x40002800 EIC size 0x44 — External Interrupt Controller
0x40002A00 EIC_SEC size 0x44
0x40002C00 FREQM size 0x14 — Frequency Meter
0x40003000 PORT size 0x80 — Port Module
0x40003200 PORT_SEC size 0x80
0x40003400 AC size 0x24 — Analog Comparators
0x41000000 IDAU size 0xD — Implementation Defined Attribution Unit
0x41002000 DSU size 0x2000 — Device Service Unit
0x41002100 DSU_EXT size 0x2000
0x41004000 NVMCTRL size 0x48 — Non-Volatile Memory Controller
0x41005000 NVMCTRL_SEC size 0x48
0x41006000 DMAC size 0x50 — Direct Memory Access Controller
0x42000000 EVSYS size 0x1F4 — Event System Interface
0x42000200 EVSYS_SEC size 0x1F4
0x42000400 SERCOM0 size 0x31 — Serial Communication Interface
0x42000800 SERCOM1 size 0x31
0x42000C00 SERCOM2 size 0x31
0x42001000 TC0 size 0x38 — Basic Timer Counter
0x42001400 TC1 size 0x38
0x42001800 TC2 size 0x38
0x42001C00 ADC size 0x2E — Analog Digital Converter
0x42002000 DAC size 0x15 — Digital Analog Converter
0x42002800 TRNG size 0x24 — True Random Generator
0x42002C00 CCL size 0x10 — Configurable Custom Logic
0x42003000 OPAMP size 0x11 — Operational Amplifier
0x42003400 TRAM size 0x200 — TrustRAM
0x60000000 PORT_IOBUS size 0x80
0x60000200 PORT_IOBUS_SEC size 0x80
0xE0001000 DWT size 0x1000 — Data Watchpoint and Trace
0xE0002000 FPB size 0x1000 — Flash Patch and Breakpoint
0xE000E000 ICB size 0xC — Implementation Control Block
0xE000E010 SysTick size 0x10 — SysTick Timer
0xE000E100 NVIC size 0x330 — Nested Vectored Interrupt Controller
0xE000ED00 SCB size 0x88 — System Control Block
0xE000ED90 MPU size 0x38 — Memory Protection Unit
0xE000EDF0 CoreDebug size 0x1C — Debug Control Block
0xE000EFB0 DIB size 0x50 — Debug Identification Block
0xE002E000 ICB_NS size 0xC
0xE002E010 SysTick_NS size 0x10
0xE002E100 NVIC_NS size 0x330
0xE002ED00 SCB_NS size 0x88
0xE002ED90 MPU_NS size 0x38
0xE002EDF0 CoreDebug_NS size 0x1C
0xE002EFB0 DIB_NS size 0x50

## Interrupts
0 SYSTEM (MCLK, OSCCTRL, OSC32KCTRL, PM, SUPC) — System peripherals shared interrupt
1 WDT — Watchdog Timer
2 RTC — Real Time Counter
3 EIC_EXTINT_0 (EIC) — External Channel 0
4 EIC_EXTINT_1 (EIC) — External Channel 1
5 EIC_EXTINT_2 (EIC) — External Channel 2
6 EIC_EXTINT_3 (EIC) — External Channel 3
7 EIC_OTHER (EIC) — External Channel 4/5/6/7
8 FREQM — Frequency Meter
9 NVMCTRL — Non-Volatile Memory Controller
10 PORT — Port Non-Secure Check
11 DMAC_0 (DMAC) — DMA Channel 0
12 DMAC_1 (DMAC) — DMA Channel 1
13 DMAC_2 (DMAC) — DMA Channel 2
14 DMAC_3 (DMAC) — DMA Channel 3
15 DMAC_OTHER (DMAC) — DMA Channel 4..X
16 EVSYS_0 (EVSYS) — Event System Channel 0
17 EVSYS_1 (EVSYS) — Event System Channel 1
18 EVSYS_2 (EVSYS) — Event System Channel 2
19 EVSYS_3 (EVSYS) — Event System Channel 3
20 EVSYS_NSCHK (EVSYS) — Event System Non-Secure Check
21 PAC — Peripheral Access Controller
22 SERCOM0_0 (SERCOM0) — Serial Communication Interface 0
23 SERCOM0_1 (SERCOM0) — Serial Communication Interface 0
24 SERCOM0_2 (SERCOM0) — Serial Communication Interface 0
25 SERCOM0_OTHER (SERCOM0) — Serial Communication Interface 0
26 SERCOM1_0 (SERCOM1) — Serial Communication Interface 1
27 SERCOM1_1 (SERCOM1) — Serial Communication Interface 1
28 SERCOM1_2 (SERCOM1) — Serial Communication Interface 1
29 SERCOM1_OTHER (SERCOM1) — Serial Communication Interface 1
30 SERCOM2_0 (SERCOM2) — Serial Communication Interface 2
31 SERCOM2_1 (SERCOM2) — Serial Communication Interface 2
32 SERCOM2_2 (SERCOM2) — Serial Communication Interface 2
33 SERCOM2_OTHER (SERCOM2) — Serial Communication Interface 2
34 TC0 — Timer Counter 0
35 TC1 — Timer Counter 1
36 TC2 — Timer Counter 2
37 ADC_OTHER (ADC) — Analog To Digital Converter
38 ADC_RESRDY (ADC) — ADC Result Ready
39 AC — Analog Comparator
40 DAC_UNDERRUN_A (DAC) — Digital to Analog Converter
41 DAC_EMPTY (DAC) — DAC Buffer 0 Empty
43 TRNG — True Random Generator
44 TRAM — Trust Ram

## Licence text in the file
Copyright (c) 2026 Microchip Technology Inc. SPDX-License-Identifier: Apache-2.0 Licensed under the Apache License, Version 2.0 (the "License"); you may not use this file except in compliance with the License. You may obtain a copy of the License at http://www.apache.org/licenses/LICENSE-2.0 Unless required by applicable law or agreed to in writing, software distributed under the License is distributed on an "AS IS" BASIS, WITHOUT WARRANTIES OR CONDITIONS OF ANY KIND, either express or implied. See the License for the specific language governing permissions and limitations under the License.
