# ATSAMA5D29TA100 register map
Vendor: Microchip Technology; Series: SAMA5D2; File version: 0
Microchip ATSAMA5D29TA100 Microcontroller
Registers are 32-bit, read-write, reset 0x0 unless marked. A register's access mark holds for its fields unless they carry their own. Offsets are from the block's base; lines under a group give offsets from that group; [hi:lo] are bit positions; {n}, {i} and the like mark numbered series; 'fields as' and 'values as' point back to an identical list; <NAME> marks a mode.

## Memory map
0x00600000 AXIMX size 0x4 — AXI Matrix
0x00A00000 L2CC size 0xF84 — L2 Cache Controller
0xA0000000 SDMMC0 size 0x244 — Secure Digital MultiMedia Card Controller
0xB0000000 SDMMC1 size 0x244
0xF0000000 LCDC size 0x1600 — LCD Controller
0xF0004000 XDMAC1 size 0x450
0xF0008000 ISC size 0xC10 — Image Sensor Controller
0xF000C000 MPDDRC size 0xEC — AHB Multiport DDR-SDRAM Controller
0xF0010000 XDMAC0 size 0x450 — Extensible DMA Controller
0xF0014000 PMC size 0x154 — Power Management Controller
0xF0018000 MATRIX0 size 0x2CC — AHB Bus Matrix
0xF001C000 AESB size 0x70 — Advanced Encryption Standard Bridge
0xF0020000 QSPI0 size 0xEC — Quad Serial Peripheral Interface
0xF0024000 QSPI1 size 0xEC
0xF0028000 SHA size 0xC0 — Secure Hash Algorithm
0xF002C000 AES size 0xE0 — Advanced Encryption Standard
0xF8000000 SPI0 size 0xEC — Serial Peripheral Interface
0xF8004000 SSC0 size 0xEC — Synchronous Serial Controller
0xF8008000 GMAC size 0x7C0 — Gigabit Ethernet MAC
0xF800C000 TC0 size 0xE8 — Timer Counter
0xF8010000 TC1 size 0xE8
0xF8014000 HSMC size 0x7EC — Static Memory Controller
0xF8018000 PDMIC size 0xEC — Pulse Density Modulation Interface Controller
0xF801C000 UART0 size 0xE8 — Universal Asynchronous Receiver Transmitter
0xF8020000 UART1 size 0xE8
0xF8024000 UART2 size 0xE8
0xF8028000 TWIHS0 size 0xEC — Two-wire Interface High Speed
0xF802C000 PWM size 0x464 — Pulse Width Modulation Controller
0xF8030000 SFR size 0x98 — Special Function Registers
0xF8034000 FLEXCOM0 size 0x6EC — Flexible Serial Communication
0xF8038000 FLEXCOM1 size 0x6EC
0xF803C000 SAIC size 0xEC
0xF8040000 ICM size 0x58 — Integrity Check Monitor
0xF8048000 RSTC size 0xC — Reset Controller
0xF8048010 SHDWC size 0x10 — Shutdown Controller
0xF8048030 PIT size 0x10 — Periodic Interval Timer
0xF8048040 WDT size 0xC — Watchdog Timer
0xF8048050 SCKC size 0x4 — Slow Clock Controller
0xF80480B0 RTC size 0xC8 — Real-time Clock
0xF8048194 SYSCWP size 0x4 — System Controller Write Protection
0xF8049000 RXLP size 0xE8 — Low Power Asynchronous Receiver
0xF804A000 ACC size 0xEC — Analog Comparator Controller
0xF804C000 SFC size 0x64 — Secure Fuse Controller
0xF8050000 I2SC0 size 0x28 — Inter-IC Sound Controller
0xF8054000 MCAN0 size 0x1B4 — Controller Area Network
0xFC000000 SPI1 size 0xEC
0xFC004000 SSC1 size 0xEC
0xFC008000 UART3 size 0xE8
0xFC00C000 UART4 size 0xE8
0xFC010000 FLEXCOM2 size 0x6EC
0xFC014000 FLEXCOM3 size 0x6EC
0xFC018000 FLEXCOM4 size 0x6EC
0xFC01C000 TRNG size 0x54 — True Random Number Generator
0xFC020000 AIC size 0xEC — Advanced Interrupt Controller
0xFC028000 TWIHS1 size 0xEC
0xFC02C000 UDPHS size 0x380 — USB High Speed Device Port
0xFC030000 ADC size 0xEC — Analog-to-Digital Converter
0xFC038000 PIO size 0x15E8 — Parallel Input/Output Controller
0xFC03C000 MATRIX1 size 0x2CC
0xFC040000 SECUMOD size 0x94 — Security Module
0xFC044000 TDES size 0x74 — Triple Data Encryption Standard
0xFC048000 CLASSD size 0xE8 — Audio Class D Amplifier (CLASSD)
0xFC04C000 I2SC1 size 0x28
0xFC050000 MCAN1 size 0x1B4
0xFC05C000 SFRBU size 0x18 — Special Function Registers Backup
0xFC060000 PTC size 0x36 — Peripheral Touch Controller
0xFC069000 CHIPID size 0x8 — Chip Identifier

## Interrupts
0 SAIC — FIQ Internal Interrupt Request
3 PIT — Periodic Interval Timer Interrupt
4 WDT — Watchdog Timer Interrupt
5 GMAC — Ethernet MAC
6 XDMAC0 — DMA Controller 0
7 XDMAC1 — DMA Controller 1
8 ICM — Integritry Check Monitor
9 AES — Advanced Enion Standard
10 AESB — AES Bridge
11 TDES — Triple Data Enion Standard
12 SHA — SHA Signature
13 MPDDRC — MPDDR Controller
14 MATRIX1 — H32MX, 32-bit AHB Matrix
15 MATRIX0 — H64MX, 64-bit AHB Matrix
16 SECUMOD — Secure Module
17 HSMC — Multibit ECC Interrupt
18 PIOA (PIO) — Parallel I/O Controller
19 FLEXCOM0
20 FLEXCOM1
21 FLEXCOM2
22 FLEXCOM3
23 FLEXCOM4
24 UART0
25 UART1
26 UART2
27 UART3
28 UART4
29 TWIHS0 — Two-Wire Interface 0
30 TWIHS1 — Two-Wire Interface 1
31 SDMMC0 — Secure Data Memory Card Controller 0
32 SDMMC1 — Secure Data Memory Card Controller 1
33 SPI0 — Serial Peripheral Interface 0
34 SPI1 — Serial Peripheral Interface 1
35 TC0 — Timer Counter 0 (ch. 0, 1, 2)
36 TC1 — Timer Counter 1 (ch. 3, 4, 5)
38 PWM — Pulse Width Modulation Controller0 (ch. 0, 1, 2, 3)
40 ADC — Touch Screen ADC Controller
42 UDPHS — USB Device High Speed
43 SSC0 — Synchronous Serial Controller 0
44 SSC1 — Synchronous Serial Controller 1
45 LCDC — LCD Controller
46 ISC — Camera Interface
47 TRNG — True Random Number Generator
48 PDMIC — Pulse Density Modulation Interface Controller
49 AIC — IRQ Internal Interrupt Request
50 SFC — Fuse Controller
52 QSPI0
53 QSPI1
54 I2SC0 — Inter-IC Sound Controller 0
55 I2SC1 — Inter-IC Sound Controller 1
56 MCAN0_INT0 (MCAN0) — Internal MCAN 0 Interrupt 0
57 MCAN1_INT0 (MCAN1) — Internal MCAN 1 Interrupt 0
58 PTC — Peripheral Touch Controller
59 CLASSD — Audio Class D amplifier
63 L2CC — L2 Cache Controller
64 MCAN0_INT1 (MCAN0) — Internal MCAN 0 Interrupt 1
65 MCAN1_INT1 (MCAN1) — Internal MCAN 1 Interrupt 1
66 GMAC_Q1 (GMAC) — GMAC Queue 1 Interrupt
67 GMAC_Q2 (GMAC) — GMAC Queue 2 Interrupt
68 PIOB (PIO) — Parallel I/O Controller
69 PIOC (PIO) — Parallel I/O Controller
70 PIOD (PIO) — Parallel I/O Controller
71 SDMMC0_TIMER (SDMMC0) — Secure Digital MultiMedia Card 0 Timer
72 SDMMC1_TIMER (SDMMC1) — Secure Digital MultiMedia Card 1 Timer
74 SYSC (PMC, RSTC, RTC) — System Controller Interrupt
75 ACC — Analog Comparator
76 RXLP — Uart Low Power

## Licence text in the file
Copyright (c) 2026 Microchip Technology Inc. SPDX-License-Identifier: Apache-2.0 Licensed under the Apache License, Version 2.0 (the "License"); you may not use this file except in compliance with the License. You may obtain a copy of the License at http://www.apache.org/licenses/LICENSE-2.0 Unless required by applicable law or agreed to in writing, software distributed under the License is distributed on an "AS IS" BASIS, WITHOUT WARRANTIES OR CONDITIONS OF ANY KIND, either express or implied. See the License for the specific language governing permissions and limitations under the License.
