# PIC32CX2051MTSH128 register map
Vendor: Microchip Technology; Series: PIC32CXMTSH; File version: 0
Microchip PIC32CX2051MTSH128 Microcontroller
CPU: CM4 r0p1, little endian, MPU, FPU, 4 interrupt priority bits, 96 interrupts
Registers are 32-bit, read-write, reset 0x0 unless marked. A register's access mark holds for its fields unless they carry their own. Offsets are from the block's base; lines under a group give offsets from that group; [hi:lo] are bit positions; {n}, {i} and the like mark numbered series; 'fields as' and 'values as' point back to an identical list; <NAME> marks a mode.

## Memory map
0x00000000 LOCKBIT size 0x40
0x40000000 FLEXCOM0 size 0x6EC — Flexible Serial Communication
0x40004000 FLEXCOM1 size 0x6EC
0x40008000 FLEXCOM2 size 0x6EC
0x4000C000 FLEXCOM3 size 0x6EC
0x40010000 FLEXCOM4 size 0x6EC
0x40014000 FLEXCOM5 size 0x6EC
0x40018000 FLEXCOM6 size 0x6EC
0x4001C000 FLEXCOM7 size 0x6EC
0x40020000 QSPI size 0x12C — Quad Serial Peripheral Interface
0x40024000 ADC size 0x154 — Analog-to-Digital Converter
0x40028000 ACC size 0xEC — Analog Comparator Controller
0x4002C000 IPC0 size 0x20 — Inter-processor Communication
0x40030000 SLCDC size 0x23C — Segment LCD Controller
0x40034000 MEM2MEM0 size 0x12C — Memory to Memory
0x40038000 TC0 size 0x12C — Timer Counter
0x4003C000 TC1 size 0x12C
0x40040000 TC2 size 0x12C
0x40044000 MATRIX1 size 0x2CC
0x40048000 PIO0 size 0x15E8 — Parallel Input/Output Controller
0x40050200 CHIPID size 0x8 — Chip Identifier
0x40050400 SFR size 0xEC — Special Function Register
0x40050600 SFRBU size 0xEC — Special Function Register Backup
0x40052000 DWDT size 0x1240 — Dual Watchdog Timer
0x40053000 RSTC size 0xC — Reset Controller
0x40053020 RTT size 0x14 — Real-time Timer
0x40053060 GPBR size 0x68 — General Purpose Backup Registers
0x40053100 RTC size 0x90 — Real-time Clock
0x400531A0 SYSCWP size 0x8 — External Interrupt Controller
0x400531D0 SUPC size 0x38 — Supply Controller
0x44000000 AES size 0x12C — Advanced Encryption Standard
0x44004000 AESB size 0xEC — Advanced Encryption Standard Bridge
0x44008000 SHA size 0x12C — Secure Hash Algorithm
0x4400C000 TRNG size 0xEC — True Random Number Generator
0x44010000 ICM size 0xEC — Integrity Check Monitor
0x46000000 CPKCC size 0xFC — Classic Public Key Cryptography Controller
0x46004000 MATRIX0 size 0x2CC — AHB Bus Matrix
0x46008000 CMCC0 size 0xE8 — Cortex-M Cache Controller
0x4600C000 CMCC1 size 0xE8
0x460E0000 SEFC0 size 0xE8 — Secure Embedded Flash Controller
0x460E0200 SEFC1 size 0xE8
0x46800000 PMC size 0xF8 — Power Management Controller
0x48000000 EMAFE size 0x12C — Energy Metering Analog Front End
0x48004000 MEM2MEM1 size 0x12C
0x48008000 TC3 size 0x12C
0x4800C000 PIO1 size 0x15E8
0x48010000 UART size 0x12C — Universal Asynchronous Receiver Transmitter
0x48014000 IPC1 size 0x20
0x48018000 MCSPI size 0x12C — Multi Channel Serial Peripheral Interface
0x4801C000 PWM size 0x454 — Pulse Width Modulation Controller
0x48020000 MATRIX3 size 0x2CC
0x4A000000 MATRIX2 size 0x2CC
0xE0000000 ITM size 0x1000 — Instrumentation Trace Macrocell
0xE0001000 DWT size 0x1000 — Data Watchpoint and Trace Register
0xE0002000 FPB size 0x1000 — Flash Patch and Breakpoint
0xE000E000 SCnSCB size 0xC — System control not in SCB
0xE000E010 SysTick size 0x10 — System timer
0xE000E100 NVIC size 0xE04 — Nested Vectored Interrupt Controller
0xE000ED00 SCB size 0x8C — System Control Block
0xE000ED90 MPU size 0x2C — Memory Protection Unit Registers
0xE000EDF0 CoreDebug size 0x10
0xE000EF30 FPU size 0x1C — Floating Point Unit
0xE0040000 TPI size 0x1000 — Trace Port Interface Register
0xE0041000 ETM size 0x1000 — Embedded Trace Macrocell

## Interrupts
0 SUPC — Supply Controller
1 RSTC — Reset Controller
2 RTC — Real Time Clock
3 RTT — Real Time Timer
4 DWDT0 (DWDT) — Dual Watchdog 0 Timer
5 DWDT1 (DWDT) — Dual Watchdog 1 Timer
6 PMC — Power Management Controller
7 SEFC0 — Embedded Flash Controller 0
8 SEFC1 — Embedded Flash Controller 1
{n+9} FLEXCOM{n} (n=0..7) — FLEXCOM {n} (USART{n}/SPI{n}/TWI{n})
23 QSPI — Quad IO Serial Peripheral Interface
24 ADC — Analog To Digital Converter
25 ACC — Analog Comparator
28 IPC0 — Application Core Interprocessor communication (IPC0)
29 SLCDC — Segment LCD Controller
30 MEM2MEM0 — Application Core Memory to Memory Transfer Controller (MEM2MEM0)
31 TC0_CHANNEL0 (TC0) — Timer Counter 0, Channel 0
32 TC0_CHANNEL1 (TC0) — Timer Counter 0, Channel 1
33 TC0_CHANNEL2 (TC0) — Timer Counter 0, Channel 2
34 TC1_CHANNEL0 (TC1) — Timer Counter 1, Channel 0
35 TC1_CHANNEL1 (TC1) — Timer Counter 1, Channel 1
36 TC1_CHANNEL2 (TC1) — Timer Counter 1, Channel 2
37 TC2_CHANNEL0 (TC2) — Timer Counter 2, Channel 0
38 TC2_CHANNEL1 (TC2) — Timer Counter 2, Channel 1
39 TC2_CHANNEL2 (TC2) — Timer Counter 2, Channel 2
40 TC0_C0SEC (TC0) — Timer Counter 0, Channel 0, Secure IRQ
41 TC0_C1SEC (TC0) — Timer Counter 0, Channel 1, Secure IRQ
42 TC0_C2SEC (TC0) — Timer Counter 0, Channel 2, Secure IRQ
43 TC1_C0SEC (TC1) — Timer Counter 1, Channel 0, Secure IRQ
44 TC1_C1SEC (TC1) — Timer Counter 1, Channel 1, Secure IRQ
45 TC1_C2SEC (TC1) — Timer Counter 1, Channel 2, Secure IRQ
46 TC2_C0SEC (TC2) — Timer Counter 2, Channel 0, Secure IRQ
47 TC2_C1SEC (TC2) — Timer Counter 2, Channel 1, Secure IRQ
48 TC2_C2SEC (TC2) — Timer Counter 2, Channel 2, Secure IRQ
49 AES — Advanced Enhanced Standard
50 AES_AESSEC (AES) — AES Secure Event Interrupt
51 AESB — AES Bridge
52 AESB_AESBSEC (AESB) — AES Bridge Secure Interrupt
53 SHA — Secure Hash Algorithm
54 SHA_SHASEC (SHA) — SHA Secure Event Interrupt
55 TRNG — True Random Generator
56 TRNG_TRNGSEC (TRNG) — TRNG Secure Event Interrupt
57 ICM — Integrity Check Module
58 ICM_ICMSEC (ICM) — Integrity Check Module
59 CPKCC — Public Key Cryptography Controller
60 MATRIX0 — High-Speed Application Core Matrix (HSACM) (MATRIX0)
61 MATRIX1 — Low-Speed Application Core Matrix (LSACM) (MATRIX1)
{n+59} SUPC_WKUP{n} (SUPC) (n=3..15) — External interrupt {n}
76 EMAFE_SLINK (EMAFE) — Energy Metering Analog Front End Serial Link Interrupt (EMAFE_SLINK)
77 EMAFE_DATA (EMAFE) — Energy Metering Analog Front End Data Ready Interrupt (EMAFE_DATA)
78 MEM2MEM1 — Metrology Core Memory to Memory Transfer Controller 1 (MEM2MEM1)
79 TC3_CHANNEL0 (TC3) — Timer Counter 3, Channel 0
80 TC3_CHANNEL1 (TC3) — Timer Counter 3, Channel 1
81 TC3_CHANNEL2 (TC3) — Timer Counter 3, Channel 2
82 TC3_C0SEC (TC3) — Timer Counter 3, Channel 0, Secure IRQ
83 TC3_C1SEC (TC3) — Timer Counter 3, Channel 1, Secure IRQ
84 TC3_C2SEC (TC3) — Timer Counter 3, Channel 2, Secure IRQ
87 UART — Optical UART
88 IPC1 — Metrology Core Interprocessor communication (IPC1)
89 MCSPI — Multi-Channel SPI
90 PWM — Pulse Width Modulation
94 MATRIX2 — High-Speed Metrology Core Matrix (HSMCM) (Formely MATRIX2)
95 MATRIX3 — Low-Speed Metrology Core Matrix (LSMCM) (Formely MATRIX3)

## Notices in the file
Copyright (c) 2025 Microchip Technology Inc.
SPDX-License-Identifier: Apache-2.0
Licensed under the Apache License, Version 2.0 (the "License");
you may not use this file except in compliance with the License.
You may obtain a copy of the License at
http://www.apache.org/licenses/LICENSE-2.0
Unless required by applicable law or agreed to in writing, software
distributed under the License is distributed on an "AS IS" BASIS,
WITHOUT WARRANTIES OR CONDITIONS OF ANY KIND, either express or implied.
See the License for the specific language governing permissions and
limitations under the License.
