# ATSAMRH707F18A register map
Vendor: Microchip Technology; Series: SAMRH707; File version: 0
Microchip ATSAMRH707F18A Microcontroller
CPU: CM7 r1p1, little endian, MPU, FPU, double-precision FPU, I-cache, D-cache, ITCM, DTCM, 3 interrupt priority bits, 69 interrupts
Registers are 32-bit, read-write, reset 0x0 unless marked. A register's access mark holds for its fields unless they carry their own. Offsets are from the block's base; lines under a group give offsets from that group; [hi:lo] are bit positions; {n}, {i} and the like mark numbered series; 'fields as' and 'values as' point back to an identical list; <NAME> marks a mode.

## Memory map
0x00000000 LOCKBIT size 0x4
0x40000000 MATRIX0 size 0x2CC — AHB Bus Matrix
0x40004000 HEFC size 0x198 — Harden Embedded Flash Controller
0x40008000 PIO size 0x5E8 — Parallel Input/Output Controller
0x4000C000 PMC size 0x1B8 — Power Management Controller
0x40014000 DACC size 0xEC — Digital-to-Analog Converter Controller
0x40018000 CRCCU size 0x50 — Cyclic Redundancy Check Calculation Unit
0x4001C000 PCC size 0xE8 — Parallel Capture Controller
0x40020000 FLEXCOM0 size 0x6EC — Flexible Serial Communication
0x40024000 FLEXCOM1 size 0x6EC
0x40028000 FLEXCOM2 size 0x6EC
0x4002C000 FLEXCOM3 size 0x6EC
0x4003C000 IP1553 size 0x54
0x40040000 SPW size 0xF10
0x40058000 MCAN0 size 0xFC — Controller Area Network
0x4005C000 MCAN1 size 0xFC
0x40068000 PWM0 size 0x464 — Pulse Width Modulation Controller
0x4006C000 PWM1 size 0x464
0x40070000 TC0 size 0xE8 — Timer Counter
0x40074000 TC1 size 0xE8
0x40078000 TC2 size 0xE8
0x40080000 HEMC size 0x198
0x40081000 HSMC size 0x78 — Harden Static Memory Controller
0x4008C000 ICM size 0xEC — Integrity Check Monitor
0x40090000 TRNG size 0x54 — True Random Number Generator
0x40094000 SHA size 0xEC — Secure Hash Algorithm
0x40098000 XDMAC size 0x850 — Extensible DMA Controller
0x400A0000 SFR size 0xE8 — Special Function Registers
0x400A8000 NMIC size 0xEC — Non-maskable Interrupt Controller
0x40100000 CHIPID size 0x8 — Chip Identifier
0x40100200 RSTC size 0xC — Reset Controller
0x40100210 SUPC size 0xD8 — Supply Controller
0x40100230 RTT size 0x10 — Real-time Timer
0x40100250 WDT size 0xC — Watchdog Timer
0x40100260 RTC size 0xD4 — Real-time Clock
0x40100300 RSWDT size 0xC — Reinforced Safety Watchdog Timer
0x40100400 TCMECC size 0x2C
0x40100600 FLEXRAMECC size 0x24
0x40200000 ADC size 0xEC — Analog-to-Digital Converter
0xE0000000 ITM size 0xE84 — Instrumentation Trace Macrocell
0xE0001000 DWT size 0x1000 — Data Watchpoint and Trace Register
0xE0002000 FPB size 0x1000 — Flash Patch and Breakpoint
0xE000E000 SCnSCB size 0xC — System control not in SCB
0xE000E010 SysTick size 0x10 — System timer
0xE000E100 NVIC size 0xE04 — Nested Vectored Interrupt Controller
0xE000ED00 SCB size 0x27C — System Control Block
0xE000ED90 MPU size 0x2C — Memory Protection Unit
0xE000EDF0 CoreDebug size 0x10
0xE000EF30 FPU size 0x1C — Floating Point Unit
0xE0040000 TPIU size 0xFD0 — Trace Port Interface Register
0xE0041000 ETM size 0x1000 — Embedded Trace Macrocell

## Interrupts
0 SUPC — Supply Controller
1 RSTC — Reset Controller
2 RTC — Real Time Clock
3 RTT — Real Time Timer
4 WDT — Watchdog Timer 0
5 PMC — Power Management Controller
6 MATRIX0
7 FLEXCOM0
8 FLEXCOM1
9 NMIC — NMI Controller
10 PIOA (PIO) — Parallel I/O Controller A
11 PIOB (PIO) — Parallel I/O Controller B
12 PIOC (PIO) — Parallel I/O Controller C
13 FLEXCOM2
14 FLEXCOM3
16 PIOD (PIO) — Parallel I/O Controller D
18 CCW (SCB) — Cache ECC Warning
19 CCF (SCB) — Cache ECC Fault
20 FPU — Floating Point Unit
21 IXC (FPU) — Floating Point Unit IXC
22 CRCCU — CRCCU_HCBDMA
23 ADC — ADC controller
24 DACC — DAC Controller
25 TC0 — Timer/Counter 0
26 TC1 (TC0) — Timer/Counter 1
27 TC2 (TC0) — Timer/Counter 2
28 TC3 (TC1) — Timer/Counter 3
29 TC4 (TC1) — Timer/Counter 4
30 TC5 (TC1) — Timer/Counter 5
31 PWM0 — Pulse Width Modulation 0
32 PWM1 — Pulse Width Modulation 1
33 ICM — Integrity Check Monitor
36 MCAN0_INT0 (MCAN0) — MCAN Controller 0 Interrupt 0
37 MCAN0_INT1 (MCAN0) — MCAN Controller 0 Interrupt 1
38 MCAN1_INT0 (MCAN1) — MCAN Controller 1 Interrupt 0
39 MCAN1_INT1 (MCAN1) — MCAN Controller 1 Interrupt 1
40 TCMECC_INTFIX (TCMECC) — TCM ECC Fixable error detected
41 TCMECC_INTNOFIX (TCMECC) — TCM ECC Un-Fixable error detected
42 FLEXRAMECC_INTFIX (FLEXRAMECC) — FlexRAM ECC Fixable error detected
43 FLEXRAMECC_INTNOFIX (FLEXRAMECC) — FlexRAM ECC Un-Fixable error detected
44 SHA — Secure Hash Algorithm
45 PCC — PCC controller
47 RSWDT — Reinforced Secure Watchdog Timer
50 HEFC_INT0 (HEFC) — HEFC Flash Interrupts
51 HEFC_INTFIX (HEFC) — HEFC ECC Fixable error detected
52 HEFC_INTNOFIX (HEFC) — HEFC ECC Un-Fixable error detected
53 TC6 (TC2) — Timer/Counter 6
54 TC7 (TC2) — Timer/Counter 7
55 TC8 (TC2) — Timer/Counter 8
59 HEMC_INTHEMC (HEMC) — HEMC Controller
60 HEMC_INTFIX (HEMC) — HEMC ECC Fixable error detected
61 HEMC_INTNOFIX (HEMC) — HEMC ECC Un-Fixable error detected
62 SFR — Special Function Register
63 TRNG — True Random Generator
64 XDMAC — eXtended DMA Controller
65 SPW — SpaceWire
68 IP1553 — MIL 1553

## Licence text in the file
Copyright (c) 2026 Microchip Technology Inc. SPDX-License-Identifier: Apache-2.0 Licensed under the Apache License, Version 2.0 (the "License"); you may not use this file except in compliance with the License. You may obtain a copy of the License at http://www.apache.org/licenses/LICENSE-2.0 Unless required by applicable law or agreed to in writing, software distributed under the License is distributed on an "AS IS" BASIS, WITHOUT WARRANTIES OR CONDITIONS OF ANY KIND, either express or implied. See the License for the specific language governing permissions and limitations under the License.
