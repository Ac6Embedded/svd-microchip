# PIC32CM5112SG00100 register map
Vendor: Microchip Technology; Series: PIC32CMSG00; File version: 0
Microchip PIC32CM5112SG00100 Microcontroller
CPU: CM23 r0p0, little endian, MPU, no FPU, 2 interrupt priority bits, 141 interrupts, 13 SAU regions
Registers are 32-bit, read-write, reset 0x0 unless marked. A register's access mark holds for its fields unless they carry their own. Offsets are from the block's base; lines under a group give offsets from that group; [hi:lo] are bit positions; {n}, {i} and the like mark numbered series; 'fields as' and 'values as' point back to an identical list; <NAME> marks a mode.

## Memory map
0x44000000 DSU size 0x2000 — Polaris Device Services Unit Macro DOS
0x44002000 FCR size 0x6C — Polaris Flash Read Controller
0x44004000 FCW size 0x80 — Polaris Flash Write Controller
0x44006000 OSCCTRL size 0x8C — Oscillators Control
0x44008000 GCLK size 0x11C — Generic Clock Generator
0x4400A000 MCLK size 0x60 — Polaris Main Clock Controller
0x4400C000 FREQM size 0x28 — Frequency Meter
0x4400E000 WDT size 0xD — Watchdog Timer
0x44010000 HMATRIX2 size 0x178 — HSB Matrix
0x44012000 IDAU size 0x2000 — Implementation Defined Attribution Unit
0x44020000 EIC size 0x44 — External Interrupt Controller
0x44022000 PAC size 0x60 — Peripheral Access Controller
0x4402C000 MCRAMC size 0x100 — Multi-Channel RAM Controller
0x4402E000 CAN0 size 0x2B4 — Control Area Network
0x44030000 CAN1 size 0x2B4
0x44032000 H2PB0 size 0x10 — AHB To APB Bridge
0x44800000 PORT size 0x200 — Port Module
0x44802000 DMAC size 0x50 — Direct Memory Access Controller
0x44804000 BROMC size 0x8 — ARM GF55LPx Boot ROM Controller Macro
0x44806000 EVSYS size 0x15E — Event System Interface
0x44808000 SERCOM0 size 0x38 — Serial Communication Interface
0x4480A000 SERCOM1 size 0x38
0x4480C000 SERCOM2 size 0x38
0x4480E000 SERCOM3 size 0x38
0x44810000 TCC0 size 0x78 — Timer Counter for Control Applications
0x44812000 TCC1 size 0x78
0x44814000 TCC2 size 0x78
0x44816000 TCC3 size 0x78
0x44818000 ADC size 0x16C — ADC Controller
0x44820000 SERCOM4 size 0x38
0x44822000 SERCOM5 size 0x38
0x44824000 TCC4 size 0x78
0x44826000 TCC5 size 0x78
0x44828000 TCC6 size 0x78
0x4482A000 AC size 0x40 — Analog Comparator Controller
0x4482C000 PTC size 0x70 — Polaris Peripheral Touch Controller
0x4482E000 CCL0 size 0x18 — Configurable Custom Logic
0x44830000 CCL1 size 0x18
0x44832000 USB size 0x200 — Full-Speed Universal Serial Bus
0x44834000 PUF size 0x300 — Physically Unclonable Function
0x44838000 H2PB1 size 0x10
0x45000000 PM size 0xA — Power Manager
0x45002000 SUPC size 0x30 — Supply Controller
0x45004000 RSTC size 0x8 — Reset Controller
0x45006000 RTC size 0x70 — Real-Time Counter
0x45008000 OSC32KCTRL size 0x20 — 32kHz Oscillators Control
0x4500A000 TRAM size 0x1200 — TrustRAM
0x4500C000 AT size 0x238 — Anti-Tamper Controller (AT)
0x4500E000 H2PB2 size 0x10
0x4F000000 HSM size 0x12028 — Cryptographic Acceleration Module Lite
0xE0001000 DWT size 0x1000 — Data Watchpoint and Trace
0xE0002000 FPB size 0x1000 — Flash Patch and Breakpoint
0xE000E000 ICB size 0xC — Implementation Control Block
0xE000E010 SysTick size 0x10 — SysTick Timer
0xE000E100 NVIC size 0x390 — Nested Vectored Interrupt Controller
0xE000ED00 SCB size 0x88 — System Control Block
0xE000ED90 MPU size 0x38 — Memory Protection Unit
0xE000EDD0 SAU size 0x14 — Security Attribution Unit
0xE000EDF0 CoreDebug size 0x1C — Debug Control Block
0xE000EFB0 DIB size 0x50 — Debug Identification Block
0xE002E000 ICB_NS size 0xC
0xE002E010 SysTick_NS size 0x10
0xE002E100 NVIC_NS size 0x390
0xE002ED00 SCB_NS size 0x88
0xE002ED90 MPU_NS size 0x38
0xE002EDF0 CoreDebug_NS size 0x1C
0xE002EFB0 DIB_NS size 0x50

## Interrupts
0 FCR
1 FCW
2 PM
3 SUPC
4 OSCCTRL_XOSCRDY (OSCCTRL)
5 OSCCTRL_DFLLRDY (OSCCTRL)
6 OSCCTRL_PLLLOCKR_0 (OSCCTRL)
7 OSC32KCTRL_XOSC32KRDY (OSC32KCTRL)
8 OSC32KCTRL_XOSC32KFAIL (OSC32KCTRL)
9 MCLK
10 FREQM
11 WDT
12 RTC_TAMPER (RTC)
13 RTC_OVF (RTC)
14 RTC_PER0 (RTC)
15 RTC_CMP0 (RTC)
{n+16} EIC_EXTINT{n} (EIC) (n=0..15)
32 EIC_NSCHK (EIC)
33 TRAM
34 MCRAMC
35 CAN0_INT0 (CAN0)
36 CAN0_INT1 (CAN0)
37 CAN0_BERR (CAN0)
38 CAN1_INT0 (CAN1)
39 CAN1_INT1 (CAN1)
40 CAN1_BERR (CAN1)
41 PORT
42 DMAC_TCMPL0 (DMAC)
43 DMAC_TCMPL1 (DMAC)
44 DMAC_TCMPL2 (DMAC)
45 DMAC_TCMPL3 (DMAC)
46 DMAC_TCMPL4 (DMAC)
47 HMATRIX2
{n+48} EVSYS_EVD{n} (EVSYS) (n=0..11)
60 SERCOM0_6 (SERCOM0)
61 SERCOM0_5 (SERCOM0)
62 SERCOM0_0 (SERCOM0)
63 SERCOM0_1 (SERCOM0)
64 SERCOM0_2 (SERCOM0)
65 SERCOM0_3 (SERCOM0)
66 SERCOM0_4 (SERCOM0)
67 SERCOM1_6 (SERCOM1)
68 SERCOM1_5 (SERCOM1)
69 SERCOM1_0 (SERCOM1)
70 SERCOM1_1 (SERCOM1)
71 SERCOM1_2 (SERCOM1)
72 SERCOM1_3 (SERCOM1)
73 SERCOM1_4 (SERCOM1)
74 SERCOM2_6 (SERCOM2)
75 SERCOM2_5 (SERCOM2)
76 SERCOM2_0 (SERCOM2)
77 SERCOM2_1 (SERCOM2)
78 SERCOM2_2 (SERCOM2)
79 SERCOM2_3 (SERCOM2)
80 SERCOM2_4 (SERCOM2)
81 SERCOM3_6 (SERCOM3)
82 SERCOM3_5 (SERCOM3)
83 SERCOM3_0 (SERCOM3)
84 SERCOM3_1 (SERCOM3)
85 SERCOM3_2 (SERCOM3)
86 SERCOM3_3 (SERCOM3)
87 SERCOM3_4 (SERCOM3)
88 TCC0_DFS (TCC0)
89 TCC0_CNT (TCC0)
90 TCC0_MC0 (TCC0)
91 TCC0_MC1 (TCC0)
92 TCC1_DFS (TCC1)
93 TCC1_CNT (TCC1)
94 TCC1_MC0 (TCC1)
95 TCC1_MC1 (TCC1)
96 TCC2_DFS (TCC2)
97 TCC2_CNT (TCC2)
98 TCC2_MC0 (TCC2)
99 TCC2_MC1 (TCC2)
100 TCC3_DFS (TCC3)
101 TCC3_CNT (TCC3)
102 TCC3_MC0 (TCC3)
103 TCC3_MC1 (TCC3)
104 SERCOM4_6 (SERCOM4)
105 SERCOM4_5 (SERCOM4)
106 SERCOM4_0 (SERCOM4)
107 SERCOM4_1 (SERCOM4)
108 SERCOM4_2 (SERCOM4)
109 SERCOM4_3 (SERCOM4)
110 SERCOM4_4 (SERCOM4)
111 SERCOM5_6 (SERCOM5)
112 SERCOM5_5 (SERCOM5)
113 SERCOM5_0 (SERCOM5)
114 SERCOM5_1 (SERCOM5)
115 SERCOM5_2 (SERCOM5)
116 SERCOM5_3 (SERCOM5)
117 SERCOM5_4 (SERCOM5)
118 TCC4_DFS (TCC4)
119 TCC4_CNT (TCC4)
120 TCC4_MC0 (TCC4)
121 TCC4_MC1 (TCC4)
122 TCC5_DFS (TCC5)
123 TCC5_CNT (TCC5)
124 TCC5_MC0 (TCC5)
125 TCC5_MC1 (TCC5)
126 TCC6_DFS (TCC6)
127 TCC6_CNT (TCC6)
128 TCC6_MC0 (TCC6)
129 TCC6_MC1 (TCC6)
130 ADC_REQ0 (ADC)
131 ADC_REQ1 (ADC)
132 AC
133 PTC
134 USB_EORSMDNRSM (USB)
135 USB_SOFHSOF (USB)
136 USB_TRCPT00 (USB)
137 USB_TRCPT10 (USB)
138 AT
139 HSM
140 PUF

## Licence text in the file
Copyright (c) 2026 Microchip Technology Inc. SPDX-License-Identifier: Apache-2.0 Licensed under the Apache License, Version 2.0 (the "License"); you may not use this file except in compliance with the License. You may obtain a copy of the License at http://www.apache.org/licenses/LICENSE-2.0 Unless required by applicable law or agreed to in writing, software distributed under the License is distributed on an "AS IS" BASIS, WITHOUT WARRANTIES OR CONDITIONS OF ANY KIND, either express or implied. See the License for the specific language governing permissions and limitations under the License.
