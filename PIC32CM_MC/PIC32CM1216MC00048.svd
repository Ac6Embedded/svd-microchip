# PIC32CM1216MC00048 register map
Vendor: Microchip Technology; Series: PIC32CMMC00; File version: 0
Microchip PIC32CM1216MC00048 Microcontroller
CPU: CM0+ r0p0, little endian, MPU, no FPU, VTOR, 2 interrupt priority bits, 27 interrupts
Registers are 32-bit, read-write, reset 0x0 unless marked. A register's access mark holds for its fields unless they carry their own. Offsets are from the block's base; lines under a group give offsets from that group; [hi:lo] are bit positions; {n}, {i} and the like mark numbered series; 'fields as' and 'values as' point back to an identical list; <NAME> marks a mode.

## Memory map
0x40000000 PAC size 0x40 — Peripheral Access Controller
0x40000400 PM size 0xA — Power Manager
0x40000800 MCLK size 0x20 — Main Clock
0x40000C00 RSTC size 0x1 — Reset Controller
0x40001000 OSCCTRL size 0x3C — Oscillators Control
0x40001400 OSC32KCTRL size 0x20 — 32k Oscillators Control
0x40001800 SUPC size 0x20 — Supply Controller
0x40001C00 GCLK size 0x10C — Generic Clock Generator
0x40002000 WDT size 0xD — Watchdog Timer
0x40002400 RTC size 0x25 — Real-Time Counter
0x40002800 EIC size 0x24 — External Interrupt Controller
0x40002C00 FREQM size 0x14 — Frequency Meter
0x40003000 TSENS size 0x25 — Temperature Sensor
0x41000000 PORT size 0x100 — Port Module
0x41002000 DSU size 0x2000 — Device Service Unit
0x41004000 NVMCTRL size 0x30 — Non-Volatile Memory Controller
0x41006000 DMAC size 0x50 — Direct Memory Access Controller
0x41008000 MTB size 0x1000 — Cortex-M0+ Micro-Trace Buffer
0x4100A000 HMATRIXHS size 0x150 — HSB Matrix
0x42000000 EVSYS size 0x13C — Event System Interface
0x42000400 SERCOM0 size 0x31 — Serial Communication Interface
0x42000800 SERCOM1 size 0x31
0x42000C00 SERCOM2 size 0x31
0x42001000 SERCOM3 size 0x31
0x42002400 TCC0 size 0x80 — Timer Counter for Control Applications
0x42002800 TCC1 size 0x80
0x42002C00 TCC2 size 0x80
0x42003000 TC0 size 0x38 — Basic Timer Counter
0x42003400 TC1 size 0x38
0x42003800 TC2 size 0x38
0x42003C00 TC3 size 0x38
0x42004000 TC4 size 0x38
0x42004400 ADC0 size 0x2E — Analog Digital Converter
0x42004800 ADC1 size 0x2E
0x42004C00 SDADC size 0x2F — Sigma-Delta Analog Digital Converter
0x42005000 AC size 0x24 — Analog Comparators
0x42005400 DAC size 0x15 — Digital Analog Converter
0x42005C00 CCL size 0x18 — Configurable Custom Logic
0x42006800 PDEC size 0x38 — Quadrature Decodeur
0x48000000 DIVAS size 0x1C — Divide and Square Root Accelerator
0x60000000 PORT_IOBUS size 0x100
0xE000E000 SystemControl size 0xD34 — System Control Registers
0xE000E010 SysTick size 0x10 — System timer
0xE000E100 NVIC size 0x320 — Nested Vectored Interrupt Controller
0xE000ED90 MPU size 0x14 — Memory Protection Unit

## Interrupts
0 SYSTEM (MCLK, OSCCTRL, OSC32KCTRL, PAC, PM, SUPC) — System peripherals shared interrupt
1 WDT — Watchdog Timer
2 RTC — Real Time Counter
3 EIC — External Interrupt Controller
4 FREQM — Frequency Meter
5 TSENS — Temperature Sensor
6 NVMCTRL — Non-Volatile Memory Controller
7 DMAC — Direct Memory Controller
8 EVSYS — Event Systems
9 SERCOM0 — Serial Communication Interface 0
10 SERCOM1 — Serial Communication Interface 1
11 SERCOM2 — Serial Communication Interface 2
12 SERCOM3 — Serial Communication Interface 3
13 TCC0 — Timer/Counter for Control Applications 0
14 TCC1 — Timer/Counter for Control Applications 1
15 TCC2 — Timer/Counter for Control Applications 2
16 TC0 — Timer/Counter 0
17 TC1 — Timer/Counter 1
18 TC2 — Timer/Counter 2
19 TC3 — Timer/Counter 3
20 TC4 — Timer/Counter 4
21 ADC0 — Analog-to-Digital Converter 0
22 ADC1 — Analog-to-Digital Converter 1
23 AC — Analog Comparators
24 DAC — Digital-to-Analog Converter
25 SDADC — Sigma-Delat Analog-to-Digital Converter
26 PDEC — Position Decoder

## Licence text in the file
Copyright (c) 2026 Microchip Technology Inc. SPDX-License-Identifier: Apache-2.0 Licensed under the Apache License, Version 2.0 (the "License"); you may not use this file except in compliance with the License. You may obtain a copy of the License at http://www.apache.org/licenses/LICENSE-2.0 Unless required by applicable law or agreed to in writing, software distributed under the License is distributed on an "AS IS" BASIS, WITHOUT WARRANTIES OR CONDITIONS OF ANY KIND, either express or implied. See the License for the specific language governing permissions and limitations under the License.
