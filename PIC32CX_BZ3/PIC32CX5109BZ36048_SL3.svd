# PIC32CX5109BZ36048_SL3 register map
Vendor: Microchip Technology; Series: PIC32CXBZ36; File version: 0
Microchip PIC32CX5109BZ36048_SL3 Microcontroller
CPU: CM4 r0p1, little endian, MPU, FPU, 3 interrupt priority bits, 43 interrupts
Registers are 32-bit, read-write, reset 0x0 unless marked. A register's access mark holds for its fields unless they carry their own. Offsets are from the block's base; lines under a group give offsets from that group; [hi:lo] are bit positions; {n}, {i} and the like mark numbered series; 'fields as' and 'values as' point back to an identical list; <NAME> marks a mode.

## Memory map
0x00000000 EFUSE size 0x1E8
0x40000000 PAC size 0x40 — Peripheral Access Controller
0x40000400 FREQM size 0x14 — Frequency Meter
0x40000800 EIC size 0x3C — External Interrupt Controller
0x40000C00 SERCOM0 size 0x31 — Serial Communication Interface
0x40001000 SERCOM1 size 0x31
0x40001400 TC0 size 0x38 — Basic Timer Counter
0x40001800 TC1 size 0x38
0x40001C00 TC2 size 0x38
0x40002000 TC3 size 0x38
0x40002400 TC4 size 0x38
0x40002800 TC5 size 0x38
0x40002C00 TC6 size 0x38
0x40003000 TC7 size 0x38
0x40003400 TCC0 size 0x88 — Timer Counter Control
0x40003800 TCC1 size 0x88
0x40003C00 TCC2 size 0x88
0x41000000 DSU size 0x2000 — Device Service Unit
0x41002000 CMCC size 0x38 — Cortex M Cache Controller
0x41004000 DMAC size 0x140 — Direct Memory Access Controller
0x41006000 EVSYS size 0x204 — Event System Interface
0x41008000 RAMECC size 0x10
0x41011000 ARB size 0x1C — Radio Arbiter
0x41012000 BLE size 0x4BC
0x41014000 BTZBSYS size 0x2C — BT ZB Subsystem
0x42000000 QSPI size 0x48 — Quad SPI interface
0x42000400 SERCOM2 size 0x31
0x42001800 CCL size 0x10 — Configurable Custom Logic
0x42001C00 AC size 0x24 — Analog Comparators
0x42002400 HMATRIX2TOP size 0x100 — HSB Matrix
0x42010000 RTC size 0x84 — Real-Time Counter
0x42011000 DSCON size 0x14
0x43000000 SILEX size 0x1405C
0x44000000 CFG size 0x204
0x44000500 WDT size 0x10 — Watch Dog Timer
0x44000600 NVM size 0x100 — flash controller
0x44000800 PFW size 0x174 — flash wrapper
0x44000A00 CRU size 0x194
0x44000A00 RCON size 0x60
0x44000E00 DMT size 0x80 — Dead Man Timer
0x44001000 PPS size 0x2FC
0x44001400 ADCHS size 0xAB4 — 12-bit Analog to Digital Converter
0x44002400 CVD size 0x204 — Hardware CVD Controller Macro
0x44002A00 GPIOA size 0xE0 — GPIO
0x44002B00 GPIOB size 0xE0
0x44002C00 ROT size 0xC0C — Secure Root of Trust Macro
0x44003C00 DAC_CTRL size 0xC — Descriptive Title of Macro
0x44003E00 DGI_SPI size 0x54 — SPI DMA for DGI Macro
0x44012400 PCHE size 0x40 — this is the PCHE
0x44013E00 PMU size 0x64 — PMU SPI controller
0xE0000000 ITM size 0x1000 — Instrumentation Trace Macrocell
0xE0001000 DWT size 0x5C — Data Watchpoint and Trace Register
0xE000E000 SystemControl size 0xD8C — System Control Registers
0xE000E010 SysTick size 0x10 — System timer
0xE000E100 NVIC size 0xE04 — Nested Vectored Interrupt Controller
0xE000ED90 MPU size 0x2C — Memory Protection Unit
0xE000EDF0 CoreDebug size 0x10
0xE000EF30 FPU size 0x18 — Floating Point Unit
0xE0040000 TPI size 0xFD0 — Trace Port Interface Register
0xE0041000 ETM size 0x1000 — Embedded Trace Macrocell

## Interrupts
0 RTC — Real Time Counter
1 EIC — External Interrupt Controller
2 DGI_SPI — DGI_SPI interrupt
3 NVM — Non-Volatile Memory
4 CHANGE_NOTICE_A (GPIOA) — PORT_A_INPUT_CHANGE_INTERRUPT
5 CHANGE_NOTICE_B (GPIOB) — PORT_B_INPUT_CHANGE_INTERRUPT
6 DMAC_0_3 (DMAC) — DMA Channel 0..3
7 DMAC_4_15 (DMAC) — DMA Channel 4..15
8 EVSYS_0_3 (EVSYS) — Event System Channel 0..3
9 EVSYS_4_11 (EVSYS) — Event System Channel 4..11
10 PAC — Peripheral Access Controller
11 RAMECC — RAM Error Correction Code
12 SERCOM0 — Serial Communication Interface 0
13 SERCOM1 — Serial Communication Interface 1
14 TCC0 — Timer/Counter for Control Applications 0
15 TCC1 — Timer/Counter for Control Applications 1
16 TCC2 — Timer/Counter for Control Applications 2
{n+17} TC{n} (n=0..7) — Timer/Counter {n}
25 ADCHS_IRQ (ADCHS) — Analog-to-Digital Converter
26 AC — Analog Comparators
27 SILEX_0 (SILEX) — Crypto 0
28 SILEX_1 (SILEX) — Crypto 1
29 QSPI — Quad SPI interface
31 BT_INT0 (BLE) — Bluetooth 0
32 BT_INT1 (BLE) — Bluetooth 1
33 ARBITER (ARB) — Radio Arbiter
34 ADCHS_FAULT (ADCHS) — ADC Fault Interrupt
35 ADCHS_FCC (ADCHS) — ADC FCC Interrupt
36 ADCHS_BGVR_RDY (ADCHS) — ADC BGVR Ready
37 CLKI_WAKEUP_NMI (BLE) — WSS WAKEUP
38 CVD — CVD Interrpt
39 PLL_LOCK (BTZBSYS) — PLL Lock (Boot ROM)
40 SERCOM2 — Serial Communication Interface 2
42 BT_LC (BLE) — Bluetooth LC

## Licence text in the file
Copyright (c) 2026 Microchip Technology Inc. SPDX-License-Identifier: Apache-2.0 Licensed under the Apache License, Version 2.0 (the "License"); you may not use this file except in compliance with the License. You may obtain a copy of the License at http://www.apache.org/licenses/LICENSE-2.0 Unless required by applicable law or agreed to in writing, software distributed under the License is distributed on an "AS IS" BASIS, WITHOUT WARRANTIES OR CONDITIONS OF ANY KIND, either express or implied. See the License for the specific language governing permissions and limitations under the License.
