# PIC32CZ2051CA90144 register map
Vendor: Microchip Technology; Series: PIC32CZCA90; File version: 0
Microchip PIC32CZ2051CA90144 Microcontroller
CPU: CM7 r1p1, little endian, MPU, FPU, double-precision FPU, I-cache, D-cache, ITCM, DTCM, 3 interrupt priority bits, 222 interrupts
Registers are 32-bit, read-write, reset 0x0 unless marked. A register's access mark holds for its fields unless they carry their own. Offsets are from the block's base; lines under a group give offsets from that group; [hi:lo] are bit positions; {n}, {i} and the like mark numbered series; 'fields as' and 'values as' point back to an identical list; <NAME> marks a mode.

## Memory map
0x40000000 PORT_AHB size 0x200
0x44000000 DSU size 0x2000 — Device Service Unit
0x44002000 FCW size 0xD0 — Flash Write Control (FCW)
0x44004000 FCR size 0x64 — Flash Read Controller (FCR)
0x44010000 PM size 0xA — Power Manager
0x44020000 SUPC size 0x30 — Supply Controller
0x44030000 RSTC size 0x8 — Reset Controller
0x44040000 OSCCTRL size 0x8C — Oscillators Control
0x44042000 OSC32KCTRL size 0x20 — 32kHz Oscillators Control
0x44050000 GCLK size 0x180 — Generic Clock Generator
0x44052000 MCLK size 0x60 — Main Clock
0x44060000 FREQM size 0x28 — Frequency Meter
0x44070000 WDT size 0xD — Watchdog Timer
0x44072000 RTC size 0x70 — Real-Time Counter
0x44080000 PRM size 0x4 — Boot ROM Controller
0x44800000 EIC size 0x3C — External Interrupt Controller
0x44810000 PAC size 0x40 — Peripheral Access Controller
0x44820000 DRMTCM size 0x50 — DRM TCM ECC
0x44822000 MCRAMC size 0x2C — Multi-Channel RAM Controller
0x44824000 TRAM size 0x3000 — TrustRAM
0x44840000 PORT size 0x200 — Port Module
0x44850000 DMA size 0x550 — Direct Memory Access Controller
0x44860000 EVSYS size 0x195 — Event System Interface
0x44870000 TRNG size 0x24 — True Random Generator
0x45010000 TCC0 size 0x90 — Timer Counter for Control Applications
0x45012000 TCC1 size 0x90
0x45014000 TCC2 size 0x90
0x45060000 CAN0 size 0x104 — Control Area Network
0x45070000 ETH size 0x1800 — Ethernet Controller
0x45800000 SERCOM2 size 0x38
0x45802000 SERCOM3 size 0x38
0x45804000 SERCOM5 size 0x38
0x45810000 TCC3 size 0x90
0x45812000 TCC4 size 0x90
0x45860000 CAN3 size 0x104
0x458A0000 SDMMC0 size 0x238 — SD/MMC Host Controller
0x458C0000 MLB size 0x7E0 — Media Local Bus
0x46000000 SERCOM0 size 0x38 — Serial Communication Interface
0x46002000 SERCOM1 size 0x38
0x46004000 SERCOM4 size 0x38
0x46010000 TCC5 size 0x90
0x46012000 TCC6 size 0x90
0x46030000 SPI_IXS0 size 0x3C — Audio SPI with 8 channels compatibilty
0x46060000 CAN1 size 0x104
0x46062000 CAN2 size 0x104
0x46810000 TCC7 size 0x90
0x46812000 TCC8 size 0x90
0x46814000 TCC9 size 0x90
0x46820000 ADC0 size 0x16C — ADC Controller
0x46822000 AC size 0x40 — Analog Comparator Controller
0x4F008000 SQI0 size 0x16C — Polaris Serial Quad Interface SIB
0x4F010000 USBHS0 size 0x1554 — USB High Speed
0x4F018000 HSM size 0x15C — Hardware Security Module
0xE0001000 DWT size 0x1000 — Data Watchpoint and Trace Register
0xE0002000 FPB size 0x1000 — Flash Patch and Breakpoint
0xE000E000 NVIC size 0x438 — Nested Vectored Interrupt Controller
0xE000E000 SystemControl size 0xD8C — System Control Registers
0xE000E010 SysTick size 0x10 — System timer
0xE000ED00 CoreDebug size 0x100
0xE000ED90 MPU size 0x2C — Memory Protection Unit
0xE000EF30 FPU size 0x1C — Floating Point Unit
0xE0040000 TPI size 0xFD0 — Trace Port Interface Register
0xE0041000 ETM size 0x1000 — Embedded Trace Macrocell
0xE0041000 ITM size 0xF00 — Instrumentation Trace Macrocell

## Interrupts
0 FCW — Flash Write Controller Interrupt
1 FCR_ECCERR (FCR) — Flash Read Controller ECC Error
2 FCR_CRC_FAULT (FCR) — Flash Read Controller CRC Fault
3 PM — Power Manager
4 SUPC — Supply Controller
5 OSCCTRL_FAIL (OSCCTRL) — External Oscillator Fail
6 OSCCTRL_XOSCRDY (OSCCTRL) — External Oscillator Ready
7 OSCCTRL_DFLLRDY (OSCCTRL) — DFLL Ready
8 OSCCTRL_OTHER (OSCCTRL) — DFLL Other Interrupt
9 OSCCTRL_LOCK (OSCCTRL) — PLL Lock
10 OSC32KCTRL_FAIL (OSC32KCTRL) — 32K Oscillator Fail
11 OSC32KCTRL_RDY (OSC32KCTRL) — 32K Oscillator Ready
12 MCLK — Main Clock
13 FREQM — Frequency Meter
14 WDT — Watchdog Timer
15 RTC_TAMPER (RTC)
16 RTC_OVF (RTC) — RTC Overflow
17 RTC_PERIOD (RTC)
18 RTC_COMPARE (RTC)
{n+19} EIC_EXTINT_{n} (EIC) (n=0..15) — External Interrupt {n}
35 PAC — Peripheral Access Controller
36 DRMTCM — TCM RAM ECC Interrupt
37 MCRAMC — Multi-Channel RAM Controller
38 TRAM — Trust RAM Interrupt
39 DMA_PRI3 (DMA) — DMA Priority 3 Interrupt
40 DMA_PRI2 (DMA) — DMA Priority 2 Interrupt
41 DMA_PRI1 (DMA) — DMA Priority 1 Interrupt
42 DMA_PRI0 (DMA) — DMA Priority 0 Interrupt
43 EVSYS_0 (EVSYS) — Event System InterruptChannel 0
{n+43} EVSYS_{n} (EVSYS) (n=1..11) — Event System Channel {n}
55 SERCOM0_6 (SERCOM0) — USART/SPI/I2C Error
56 SERCOM0_5 (SERCOM0) — USART Receive Break
57 SERCOM0_0 (SERCOM0) — USART-SPI Data Register Empty/ I2C Stop Received
58 SERCOM0_1 (SERCOM0) — USART-SPI Transmit Complete/ I2C Address Match
59 SERCOM0_2 (SERCOM0) — USART-SPI Receive Complete/ I2C Data Ready
60 SERCOM0_3 (SERCOM0) — USART Receive Start/ SPI Slave Select Low/ I2C TX FIFO Empty
61 SERCOM0_4 (SERCOM0) — USART Clear To Send Input Change/ I2C RX FIFO Full
62 SERCOM1_6 (SERCOM1) — USART/SPI/I2C Error
63 SERCOM1_5 (SERCOM1) — USART Receive Break
64 SERCOM1_0 (SERCOM1) — USART-SPI Data Register Empty/ I2C Stop Received
65 SERCOM1_1 (SERCOM1) — USART-SPI Transmit Complete/ I2C Address Match
66 SERCOM1_2 (SERCOM1) — USART-SPI Receive Complete/ I2C Data Ready
67 SERCOM1_3 (SERCOM1) — USART Receive Start/ SPI Slave Select Low/ I2C TX FIFO Empty
68 SERCOM1_4 (SERCOM1) — USART Clear To Send Input Change/ I2C RX FIFO Full
69 SERCOM2_6 (SERCOM2) — USART/SPI/I2C Error
70 SERCOM2_5 (SERCOM2) — USART Receive Break
71 SERCOM2_0 (SERCOM2) — USART-SPI Data Register Empty/ I2C Stop Received
72 SERCOM2_1 (SERCOM2) — USART-SPI Transmit Complete/ I2C Address Match
73 SERCOM2_2 (SERCOM2) — USART-SPI Receive Complete/ I2C Data Ready
74 SERCOM2_3 (SERCOM2) — USART Receive Start/ SPI Slave Select Low/ I2C TX FIFO Empty
75 SERCOM2_4 (SERCOM2) — USART Clear To Send Input Change/ I2C RX FIFO Full
76 SERCOM3_6 (SERCOM3) — USART/SPI/I2C Error
77 SERCOM3_5 (SERCOM3) — USART Receive Break
78 SERCOM3_0 (SERCOM3) — USART-SPI Data Register Empty/ I2C Stop Received
79 SERCOM3_1 (SERCOM3) — USART-SPI Transmit Complete/ I2C Address Match
80 SERCOM3_2 (SERCOM3) — USART-SPI Receive Complete/ I2C Data Ready
81 SERCOM3_3 (SERCOM3) — USART Receive Start/ SPI Slave Select Low/ I2C TX FIFO Empty
82 SERCOM3_4 (SERCOM3) — USART Clear To Send Input Change/ I2C RX FIFO Full
83 SERCOM4_6 (SERCOM4) — USART/SPI/I2C Error
84 SERCOM4_5 (SERCOM4) — USART Receive Break
85 SERCOM4_0 (SERCOM4) — USART-SPI Data Register Empty/ I2C Stop Received
86 SERCOM4_1 (SERCOM4) — USART-SPI Transmit Complete/ I2C Address Match
87 SERCOM4_2 (SERCOM4) — USART-SPI Receive Complete/ I2C Data Ready
88 SERCOM4_3 (SERCOM4) — USART Receive Start/ SPI Slave Select Low/ I2C TX FIFO Empty
89 SERCOM4_4 (SERCOM4) — USART Clear To Send Input Change/ I2C RX FIFO Full
90 SERCOM5_6 (SERCOM5) — USART/SPI/I2C Error
91 SERCOM5_5 (SERCOM5) — USART Receive Break
92 SERCOM5_0 (SERCOM5) — USART-SPI Data Register Empty/ I2C Stop Received
93 SERCOM5_1 (SERCOM5) — USART-SPI Transmit Complete/ I2C Address Match
94 SERCOM5_2 (SERCOM5) — USART-SPI Receive Complete/ I2C Data Ready
95 SERCOM5_3 (SERCOM5) — USART Receive Start/ SPI Slave Select Low/ I2C TX FIFO Empty
96 SERCOM5_4 (SERCOM5) — USART Clear To Send Input Change/ I2C RX FIFO Full
125 TCC0_OTHER (TCC0) — Error/Overflow/Underflow/Fault Interrupt
126 TCC0_CNT_TRIG (TCC0) — Counter/Re-Trigger Interrupt
{n+127} TCC0_MC{n} (TCC0) (n=0..7) — TCC Match/Compare {n}
135 TCC1_OTHER (TCC1) — Error/Overflow/Underflow/Fault Interrupt
136 TCC1_CNT_TRIG (TCC1) — Counter/Re-Trigger Interrupt
{n+137} TCC1_MC{n} (TCC1) (n=0..7) — TCC Match/Compare {n}
145 TCC2_OTHER (TCC2) — Error/Overflow/Underflow/Fault Interrupt
146 TCC2_CNT_TRIG (TCC2) — Counter/Re-Trigger Interrupt
147 TCC2_MC0 (TCC2) — TCC Match/Compare 0
148 TCC2_MC1 (TCC2) — TCC Match/Compare 1
149 TCC2_MC2 (TCC2) — TCC Match/Compare 2
150 TCC2_MC3 (TCC2) — TCC Match/Compare 3
151 TCC2_MC4 (TCC2) — TCC Match/Compare 4
152 TCC2_MC5 (TCC2) — TCC Match/Compare 5
153 TCC3_OTHER (TCC3) — Error/Overflow/Underflow/Fault Interrupt
154 TCC3_CNT_TRIG (TCC3) — Counter/Re-Trigger Interrupt
155 TCC3_MC0 (TCC3) — TCC Match/Compare 0
156 TCC3_MC1 (TCC3) — TCC Match/Compare 1
157 TCC4_OTHER (TCC4) — Error/Overflow/Underflow/Fault Interrupt
158 TCC4_CNT_TRIG (TCC4) — Counter/Re-Trigger Interrupt
159 TCC4_MC0 (TCC4) — TCC Match/Compare 0
160 TCC4_MC1 (TCC4) — TCC Match/Compare 1
161 TCC5_OTHER (TCC5) — Error/Overflow/Underflow/Fault Interrupt
162 TCC5_CNT_TRIG (TCC5) — Counter/Re-Trigger Interrupt
163 TCC5_MC0 (TCC5) — TCC Match/Compare 0
164 TCC5_MC1 (TCC5) — TCC Match/Compare 1
165 TCC6_OTHER (TCC6) — Error/Overflow/Underflow/Fault Interrupt
166 TCC6_CNT_TRIG (TCC6) — Counter/Re-Trigger Interrupt
167 TCC6_MC0 (TCC6) — TCC Match/Compare 0
168 TCC6_MC1 (TCC6) — TCC Match/Compare 1
169 TCC7_OTHER (TCC7) — Error/Overflow/Underflow/Fault Interrupt
170 TCC7_CNT_TRIG (TCC7) — Counter/Re-Trigger Interrupt
171 TCC7_MC0 (TCC7) — TCC Match/Compare 0
172 TCC7_MC1 (TCC7) — TCC Match/Compare 1
173 TCC8_OTHER (TCC8) — Error/Overflow/Underflow/Fault Interrupt
174 TCC8_CNT_TRIG (TCC8) — Counter/Re-Trigger Interrupt
175 TCC8_MC0 (TCC8) — TCC Match/Compare 0
176 TCC8_MC1 (TCC8) — TCC Match/Compare 1
177 TCC9_OTHER (TCC9) — Error/Overflow/Underflow/Fault Interrupt
178 TCC9_CNT_TRIG (TCC9) — Counter/Re-Trigger Interrupt
179 TCC9_MC0 (TCC9) — TCC Match/Compare 0
180 TCC9_MC1 (TCC9) — TCC Match/Compare 1
181 TCC9_MC2 (TCC9) — TCC Match/Compare 2
182 TCC9_MC3 (TCC9) — TCC Match/Compare 3
183 TCC9_MC4 (TCC9) — TCC Match/Compare 4
184 TCC9_MC5 (TCC9) — TCC Match/Compare 5
185 ADC_GLOBAL (ADC0) — ADC Global Interrupt
186 ADC_CORE1 (ADC0) — ADC Core 1 Interrupt
190 AC — Analog Comparator Interrupt
192 SPI_IXS0 — Audio SPI Interrupt 0
194 CAN0 — Controller Area Network 0
195 CAN1 — Controller Area Network 1
196 CAN2 — Controller Area Network 2
197 CAN3 — Controller Area Network 3
202 ETH_PRI_Q_0 (ETH) — Ethernet MAC Interrupt
203 ETH_PRI_Q_1 (ETH) — Ethernet MAC Queue 1 Interrupt
204 ETH_PRI_Q_2 (ETH) — Ethernet MAC Queue 2 Interrupt
205 ETH_PRI_Q_3 (ETH) — Ethernet MAC Queue 3 Interrupt
206 ETH_PRI_Q_4 (ETH) — Ethernet MAC Queue 4 Interrupt
207 ETH_PRI_Q_5 (ETH) — Ethernet MAC Queue 5 Interrupt
208 SQI0 — Quad SPI Interrupt 0
210 TRNG — True Random Generator
211 SDMMC0 — SD/MMC Host Controller Interrupt 0
213 USBHS0 — High Speed USB Interrupt 0
215 HSM_TAMPER (HSM) — Hardware Security Module Tamper Interrupt
216 HSM_TXINT (HSM) — Hardware Security Module Transmit Interrupt
217 HSM_RXINT (HSM) — Hardware Security Module Receive Interrupt
218 MLB_GENERAL (MLB) — Media Local Bus General Interrupt
219 MLB_BUSREQ (MLB) — Media Local Bus Request Interrupt

## Licence text in the file
Copyright (c) 2026 Microchip Technology Inc. SPDX-License-Identifier: Apache-2.0 Licensed under the Apache License, Version 2.0 (the "License"); you may not use this file except in compliance with the License. You may obtain a copy of the License at http://www.apache.org/licenses/LICENSE-2.0 Unless required by applicable law or agreed to in writing, software distributed under the License is distributed on an "AS IS" BASIS, WITHOUT WARRANTIES OR CONDITIONS OF ANY KIND, either express or implied. See the License for the specific language governing permissions and limitations under the License.
