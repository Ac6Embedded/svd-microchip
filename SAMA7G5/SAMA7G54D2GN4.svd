# SAMA7G54D2GN4 register map
Vendor: Microchip Technology; Series: SAMA7G5; File version: 0
Microchip SAMA7G54D2GN4 Microcontroller
Registers are 32-bit, read-write, reset 0x0 unless marked. A register's access mark holds for its fields unless they carry their own. Offsets are from the block's base; lines under a group give offsets from that group; [hi:lo] are bit positions; {n}, {i} and the like mark numbered series; 'fields as' and 'values as' point back to an identical list; <NAME> marks a mode.

## Memory map
0x00400000 UHPFS size 0x60 — USB Host Full-Speed Port
0x00500000 UHPHS size 0xB0 — USB Host High Speed Port
0xE0004000 SECUMOD size 0xA0 — Security Module
0xE0008000 SFRBU size 0x14 — Special Function Register Backup
0xE0010000 TZPM size 0x18 — System Interconnect and Security
0xE0014000 PIO size 0x15E8 — Parallel Input/Output Controller
0xE0018000 PMC size 0xF4 — Power Management Controller
0xE001C000 DWDT size 0x11B0 — Dual Watchdog Timer
0xE001D000 RSTC size 0xE8 — Reset Controller
0xE001D010 SHDWC size 0x10 — Shutdown Controller
0xE001D020 RTT size 0x18 — Real-time Timer
0xE001D050 SCKC size 0x4 — Slow Clock Controller
0xE001D054 BSC size 0x4 — Boot Sequence Controller
0xE001D060 GPBR size 0x10 — General Purpose Backup Registers
0xE001D0A8 RTC size 0xC8 — Real-time Clock
0xE001D0DC SYSCWP size 0x8 — System Controller Write Protection
0xE0020000 CHIPID size 0x8 — Chip Identifier
0xE0800000 TC1 size 0xE8
0xE0804000 MATRIX size 0x2A8 — AHB Bus Matrix (MATRIX2)
0xE0808000 HSMC size 0x7EC — Static Memory Controller
0xE080C000 QSPI0 size 0xEC — Quad Serial Peripheral Interface
0xE0810000 QSPI1 size 0xEC
0xE0814000 UDPHSA size 0x380 — IP_Name
0xE0818000 UDPHSB size 0x380
0xE081C000 ICM size 0xEC — Integrity Check Monitor
0xE0820000 TZAESB size 0xEC — TrustZone Advanced Encryption Standard Bridge
0xE0824000 TZAESBS size 0xEC
0xE0828000 MCAN0 size 0xFC — Controller Area Network
0xE082C000 MCAN1 size 0xFC
0xE0830000 MCAN2 size 0xFC
0xE0834000 MCAN3 size 0xFC
0xE0838000 MCAN4 size 0xFC
0xE083C000 MCAN5 size 0xFC
0xE0840000 TCPCA size 0xA8 — Battery Charging and Type-C Port Controller
0xE0844000 TCPCB size 0xA8
0xE1000000 ADC size 0x120 — Analog-to-Digital Converter
0xE1200000 XDMAC2 size 0x860
0xE1204000 SDMMC0 size 0x246 — Secure Digital MultiMedia Card Controller
0xE1208000 SDMMC1 size 0x246
0xE120C000 SDMMC2 size 0x246
0xE1400000 CSI size 0x30C — CSI Host Controller
0xE1404000 CSI2DC size 0x10C — CSI-2 Demultiplexer Controller
0xE1408000 ISC size 0xD5C — Image Sensor Controller
0xE1600000 ACC size 0xEC — Analog Comparator Controller
0xE1604000 PWM size 0x464 — Pulse Width Modulation Controller
0xE1608000 PDMC0 size 0x34 — Pulse Density Microphone Controller
0xE160C000 PDMC1 size 0x34
0xE1610000 ASRC size 0xEC — Asynchronous Sample Rate Converter
0xE1614000 SPDIFRX size 0xEC — Sony/Philips Digital Interface Receiver
0xE1618000 SPDIFTX size 0xE8 — Sony/Philips Digital Interface
0xE161C000 I2SMCC0 size 0xEC — Inter-IC Sound Multi Channel Controller
0xE1620000 I2SMCC1 size 0xEC
0xE1624000 SFR size 0x204C — Special Function Registers
0xE1628000 EIC size 0xEC — External Interrupt Controller
0xE1800000 PIT64B0 size 0xEC — Periodic Interval Timer 64-bit
0xE1804000 PIT64B1 size 0xEC
0xE1808000 PIT64B2 size 0xEC
0xE180C000 SSC0 size 0xEC — Synchronous Serial Controller
0xE1810000 AES size 0xEC — Advanced Encryption Standard
0xE1814000 SHA size 0xEC — Secure Hash Algorithm
0xE1818000 FLEXCOM0 size 0x6EC — Flexible Serial Communication
0xE181C000 FLEXCOM1 size 0x6EC
0xE1820000 FLEXCOM2 size 0x6EC
0xE1824000 FLEXCOM3 size 0x6EC
0xE2000000 TZAESBASC size 0xEC — AES Bridge Address Space Controller
0xE2004000 PIT64B3 size 0xEC
0xE2008000 PIT64B4 size 0xEC
0xE200C000 SSC1 size 0xEC
0xE2010000 TRNG size 0xEC — True Random Number Generator
0xE2014000 TDES size 0xEC — Triple Data Encryption Standard
0xE2018000 FLEXCOM4 size 0x6EC
0xE201C000 FLEXCOM5 size 0x6EC
0xE2020000 FLEXCOM6 size 0x6EC
0xE2024000 FLEXCOM7 size 0x6EC
0xE2800000 GMAC0 size 0x7C0 — Gigabit Ethernet MAC
0xE2804000 GMAC1 size 0x7C0
0xE2808000 XDMAC0 size 0x860 — Extensible DMA Controller
0xE280C000 XDMAC1 size 0x860
0xE2810000 PIT64B5 size 0xEC
0xE2814000 TC0 size 0xE8 — Timer Counter
0xE2818000 FLEXCOM8 size 0x6EC
0xE281C000 FLEXCOM9 size 0x6EC
0xE2820000 FLEXCOM10 size 0x6EC
0xE2824000 FLEXCOM11 size 0x6EC
0xE3000000 TZC size 0x2000 — TrustZone Address Space Controller
0xE3800000 DDRUMCTL size 0xF0C — Enhanced Universal DDR-SDRAM Memory Controller
0xE3804000 DDRPUBL size 0x218 — DDR SDRAM PHY Utility Block Lite
0xE8B00000 NICGPV size 0xC4008 — NIC-400 Global Programmers View
0xE8C00000 OTPC size 0xEC — OTP Memory Controller

## Interrupts
32 DWDT_SW (DWDT) — Dual Watchdog Timer, Secure World
33 DWDT_NSW (DWDT) — Dual Watchdog Timer, Non Secure World, interrupt
34 DWDT_NSW_ALARM (DWDT) — Dual Watchdog Timer, Non Secure World Alarm, interrupt
36 SCKC — Slow Clock Controller
37 SHDWC — SHutDoWn Controller
38 RSTC — Reset Controller
39 RTC — Real-Time Clock
40 RTT — Real-Time Timer
42 PMC — Power Management Controller
43 PIOA (PIO) — For PIO 0 to 31
44 PIOB (PIO) — For PIO 32 to 63, interrupt
45 PIOC (PIO) — For PIO 64 to 95, interrupt
46 PIOD (PIO) — For PIO 96 to 127, interrupt
47 PIOE (PIO) — For PIO 128 to 136, interrupt
49 SECUMOD — Security Module
51 SFR — Special Function Register
53 HSMC — Static Memory Controller - NAND Flash Controller
54 XDMAC0 — DMA 0, mem to periph, 32 Channels
55 XDMAC1 — DMA 1, mem to periph, 32 Channels
56 XDMAC2 — DMA 2, mem to mem, 4 Channels
57 ACC — Analog Comparator Controller
58 ADC — Analog-to-Digital Converter
59 AES — Advanced Encryption Standard
62 ASRC — Asynchronous Sample Rate Converter
65 CSI — Camera Serial Interface 2 between ISC and MIPI PHY
66 CSI2DC — CSI to Demultiplexer Controller
{n+70} FLEXCOM{n} (n=0..11)
83 GMAC0 — Gigabit Ethernet MAC
84 GMAC1 — Ethernet MAC
85 GMAC0_TSU (GMAC0) — Gigabit Ethernet MAC - Time Stamp Unit Generic Clock - No Interrupt
86 GMAC1_TSU (GMAC1) — Ethernet MAC - Time Stamp Unit Generic Clock - No Interrupt
87 ICM — Integrity Check Monitor
88 ISC — Camera Interface
89 I2SMCC0 — Inter-IC Sound Controller 0
90 I2SMCC1 — Inter-IC Sound Controller 1
92 MATRIX — HSS AHB Matrix
93 MCAN0_INT0 (MCAN0) — Master CAN 0
94 MCAN1_INT0 (MCAN1) — Master CAN 1
95 MCAN2_INT0 (MCAN2) — Master CAN 2
96 MCAN3_INT0 (MCAN3) — Master CAN 3
97 MCAN4_INT0 (MCAN4) — Master CAN 4
98 MCAN5_INT0 (MCAN5) — Master CAN 5
99 OTPC — One Time Programmable memory Controller
100 PDMC0 — Pulse Density Modulation Interface Controller 0
101 PDMC1 — Pulse Density Modulation Interface Controller 1
102 PIT64B0 — 64-bit Periodic Interval Timer 0
103 PIT64B1 — 64-bit Periodic Interval Timer 1
104 PIT64B2 — 64-bit Periodic Interval Timer 2
105 PIT64B3 — 64-bit Periodic Interval Timer 3
106 PIT64B4 — 64-bit Periodic Interval Timer 4
107 PIT64B5 — 64-bit Periodic Interval Timer 5
109 PWM — Pulse Width Modulation
110 QSPI0 — Quad IO Serial Peripheral Interface 0
111 QSPI1 — Quad IO Serial Peripheral Interface 1
112 SDMMC0 — Ultra High Speed SD Host controller 0 (eMMC 5.1)
113 SDMMC1 — Ultra High Speed SD Host controller 1 (eMMC 4.51)
114 SDMMC2 — Ultra High Speed SD Host controller 2 (eMMC 4.51)
115 SHA — Secure Hash Algorithm
116 SPDIFRX — Sony Philips Digital Interface RX
117 SPDIFTX — Sony Philips Digital Interface TX
118 SSC0 — Synchronous Serial Interface 0
119 SSC1 — Synchronous Serial Interface 1
120 TC0_CH0 (TC0) — 32-bit Timer Counter 0 Channel 0 interrupt
121 TC0_CH1 (TC0) — 32-bit Timer Counter 0 Channel 1 interrupt
122 TC0_CH2 (TC0) — 32-bit Timer Counter 0 Channel 2 interrupt
123 TC1_CH0 (TC1) — 32-bit Timer Counter 1 Channel 0 interrupt
124 TC1_CH1 (TC1) — 32-bit Timer Counter 1 Channel 1 interrupt
125 TC1_CH2 (TC1) — 32-bit Timer Counter 1 Channel 2 interrupt
126 TCPCA — USB Type-C Port Controller A
127 TCPCB — USB Type-C Port Controller B
128 TDES — Triple Data Encryption System
129 TRNG — True Random Number Generator
130 TZAESB_NS (TZAESB) — TrustZone Advanced Encryption Standard Bridge Non-Secure (Clocks & Interrupt)
131 TZAESB_NS_SINT (TZAESB) — TrustZone Advanced Encryption Standard Bridge Non-Secure (Interrupt only)
132 TZAESB_S (TZAESB) — TrustZone Advanced Encryption Standard Bridge Secure
133 TZAESB_S_SINT (TZAESB) — TrustZone Advanced Encryption Standard Bridge Secure (Interrupt only)
134 TZC — TrustZone Address Space Controller (TZC-400)
135 TZPM — TrustZone Peripheral Manager
136 UDPHSA — USB Device High Speed A
137 UDPHSB — USB Device High Speed B
138 UHPHS — USB Host Controller High Speed
144 XDMAC0_SINT (XDMAC0) — DMA 0, mem to periph, 32 Channels, Secure INTerrupt
145 XDMAC1_SINT (XDMAC1) — DMA 1, mem to periph, 32 Channels, Secure INTerrupt
146 XDMAC2_SINT (XDMAC2) — DMA 2, mem to mem, 4 Channels, Secure INTerrupt
147 AES_SINT (AES) — Advanced Encryption Standard, Secure INTerrupt
148 GMAC0_Q1 (GMAC0) — GMAC0 Queue 1 Interrupt signal toggled on a DMA write to the first word of each DMA data buffer associated with queue 1
149 GMAC0_Q2 (GMAC0) — GMAC0 Queue 2 Interrupt signal toggled on a DMA write to the first word of each DMA data buffer associated with queue 2
150 GMAC0_Q3 (GMAC0) — GMAC0 Queue 3 Interrupt signal toggled on a DMA write to the first word of each DMA data buffer associated with queue 3
151 GMAC0_Q4 (GMAC0) — GMAC0 Queue 4 Interrupt signal toggled on a DMA write to the first word of each DMA data buffer associated with queue 4
152 GMAC0_Q5 (GMAC0) — GMAC0 Queue 5 Interrupt signal toggled on a DMA write to the first word of each DMA data buffer associated with queue 5
153 GMAC1_Q1 (GMAC1) — GMAC1 Queue 1 Interrupt signal toggled on a DMA write to the first word of each DMA data buffer associated with queue 1
154 ICM_SINT (ICM) — Integrity Check Monitor, Secure INTerrupt
155 MCAN0_INT1 (MCAN0) — MCAN0 interrupt1
156 MCAN1_INT1 (MCAN1) — MCAN1 interrupt1
157 MCAN2_INT1 (MCAN2) — MCAN2 interrupt1
158 MCAN3_INT1 (MCAN3) — MCAN3 interrupt1
159 MCAN4_INT1 (MCAN4) — MCAN4 interrupt1
160 MCAN5_INT1 (MCAN5) — MCAN5 interrupt1
161 PIOA_SINT (PIO) — For PIO 0 to 31, Secure INTerrupt
162 PIOB_SINT (PIO) — For PIO 32 to 63, Secure INTerrupt
163 PIOC_SINT (PIO) — For PIO 64 to 95, Secure INTerrupt
164 PIOD_SINT (PIO) — For PIO 96 to 127, Secure INTerrupt
165 PIOE_SINT (PIO) — For PIO 128 to 136, Secure INTerrupt
167 PIT64B0_SINT (PIT64B0) — 64-bit Periodic Interval Timer 0, Secure INTerrupt
168 PIT64B1_SINT (PIT64B1) — 64-bit Periodic Interval Timer 1, Secure INTerrupt
169 PIT64B2_SINT (PIT64B2) — 64-bit Periodic Interval Timer 2, Secure INTerrupt
170 PIT64B3_SINT (PIT64B3) — 64-bit Periodic Interval Timer 3, Secure INTerrupt
171 PIT64B4_SINT (PIT64B4) — 64-bit Periodic Interval Timer 4, Secure INTerrupt
172 PIT64B5_SINT (PIT64B5) — 64-bit Periodic Interval Timer 5, Secure INTerrupt
173 SDMMC0_TIMER (SDMMC0) — Ultra High Speed SD Host controller 0 (eMMC 5.1) Timer interrupt
174 SDMMC1_TIMER (SDMMC1) — Ultra High Speed SD Host controller 1 (eMMC 4.51) Timer interrupt
175 SDMMC2_TIMER (SDMMC2) — Ultra High Speed SD Host controller 2 (eMMC 4.51) Timer interrupt
176 SHA_SINT (SHA) — Secure Hash Algorithm, Secure INTerrupt
177 TC0_SINT0 (TC0) — 32-bit Timer Counter 0 Channel 0, Secure INTerrupt
178 TC0_SINT1 (TC0) — 32-bit Timer Counter 0 Channel 1, Secure INTerrupt
179 TC0_SINT2 (TC0) — 32-bit Timer Counter 0 Channel 2
180 TC1_SINT0 (TC1) — 32-bit Timer Counter 1 Channel 0, Secure INTerrupt
181 TC1_SINT1 (TC1) — 32-bit Timer Counter 1 Channel 1, Secure INTerrupt
182 TC1_SINT2 (TC1) — 32-bit Timer Counter 1 Channel 2, Secure INTerrupt
183 TDES_SINT (TDES) — Triple Data Encryption System, Secure INTerrupt
184 TRNG_SINT (TRNG) — True Random Number Generator, Secure INTerrupt
185 EIC_EXT_IRQ0 (EIC) — External Interrupt ID0 (FIQ)
186 EIC_EXT_IRQ1 (EIC) — External Interrupt ID1 (IRQ)

## Licence text in the file
Copyright (c) 2026 Microchip Technology Inc. SPDX-License-Identifier: Apache-2.0 Licensed under the Apache License, Version 2.0 (the "License"); you may not use this file except in compliance with the License. You may obtain a copy of the License at http://www.apache.org/licenses/LICENSE-2.0 Unless required by applicable law or agreed to in writing, software distributed under the License is distributed on an "AS IS" BASIS, WITHOUT WARRANTIES OR CONDITIONS OF ANY KIND, either express or implied. See the License for the specific language governing permissions and limitations under the License.
